AUTOSAR XML (schema 4-0-3)
package /TS_T40D13M1I0R0
  module config Fls_Rec: definition=Fls
  bsw implementation Fls_Impl: programming-language=C, behavior=FlsBehavior, recommended-configuration=Fls_Rec, vendor-specific-module-def=Fls
