AUTOSAR XML (schema 4-0-3)
package /TS_T40D13M1I0R0
  module config Port_Rec: definition=Port
  bsw implementation Port_Impl: programming-language=C, behavior=PortBehavior, recommended-configuration=Port_Rec, vendor-specific-module-def=Port
