AUTOSAR XML (schema 4-0-3)
package /TS_T40D13M1I0R0
  module config Wdg_Rec: definition=Wdg
  bsw implementation Wdg_Impl: programming-language=C, vendor-id=66, behavior=WdgBehavior, recommended-configuration=Wdg_Rec, vendor-api-infix=IA, vendor-specific-module-def=Wdg
