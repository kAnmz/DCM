AUTOSAR XML (schema 4-0-3)
package /TS_T40D13M1I0R0
  module config Gpt_Rec: definition=Gpt
  bsw implementation Gpt_Impl: programming-language=C, behavior=GptBehavior, recommended-configuration=Gpt_Rec, vendor-specific-module-def=Gpt
