AUTOSAR XML (schema 4-0-3)
package /TS_T40D13M1I0R0
  module config Mcu_Rec: definition=Mcu
  bsw implementation Mcu_Impl: programming-language=C, behavior=McuBehavior, recommended-configuration=Mcu_Rec, vendor-specific-module-def=Mcu
