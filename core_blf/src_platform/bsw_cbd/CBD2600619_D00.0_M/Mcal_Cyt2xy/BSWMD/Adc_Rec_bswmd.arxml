AUTOSAR XML (schema 4-0-3)
package /TS_T40D13M1I0R0
  module config Adc_Rec: definition=Adc
  bsw implementation Adc_Impl: programming-language=C, behavior=AdcBehavior, recommended-configuration=Adc_Rec, vendor-specific-module-def=Adc
