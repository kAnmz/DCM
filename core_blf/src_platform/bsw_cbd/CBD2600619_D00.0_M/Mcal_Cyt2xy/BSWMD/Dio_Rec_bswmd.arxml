AUTOSAR XML (schema 4-0-3)
package /TS_T40D13M1I0R0
  module config Dio_Rec: definition=Dio
  bsw implementation Dio_Impl: programming-language=C, behavior=DioBehavior, recommended-configuration=Dio_Rec, vendor-specific-module-def=Dio
