AUTOSAR XML (schema 4-0-3)
package /TS_T40D13M1I0R0
  module config Ocu_Rec: definition=Ocu
  bsw implementation Ocu_Impl: programming-language=C, behavior=OcuBehavior, recommended-configuration=Ocu_Rec, vendor-specific-module-def=Ocu
