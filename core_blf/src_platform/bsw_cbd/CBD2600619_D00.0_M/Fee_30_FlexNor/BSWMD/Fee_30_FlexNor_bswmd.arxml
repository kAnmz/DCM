AUTOSAR XML (schema 00048)
# COPYRIGHT
# Copyright (c) 2025 by Vector Informatik GmbH. All rights reserved.
# This software is copyright protected and proprietary to Vector Informatik GmbH.
# Vector Informatik GmbH grants to you only those rights as set out in the license conditions.
package /MICROSAR/Fee_30_FlexNor
  module definition Fee [0..1]: category=VENDOR_SPECIFIC_MODULE_DEFINITION, refined-module-def=Fee, variants pre-compile/link-time  # Flash EEPROM Emulation. Provides access to Flash EEPROM for reading and storing data persistently. Optimized for different kinds of NOR flash. #NVRAM #NVMemory #DataStorage #Flash #AUTOSAR
    container FeeBlockConfiguration [1..*]: multiplicity set at pre-compile  # Configuration of block specific parameters for the Flash EEPROM Emulation module.
      integer FeeBlockNumber: 1..65534, scope=ECU, multiplicity set at pre-compile, set at pre-compile, symbolic-name-value=true, default-value=1  # Block identifier (handle). | 0x0000 and 0xFFFF shall not be used for block numbers (see FEE006). Range: min = 2^NVM_DATASET_SELECTION_BITS max = 0xFFFF -2^NVM_DATASET_SELECTION_BITS Note: Depending on the number of bits set aside for dataset selection several other block numbers shall also be left out to ease implementation.
      integer FeeBlockSize: 1..65535, scope=ECU, multiplicity set at pre-compile, set at pre-compile, default-value=1  # Size of a logical block in bytes.
      boolean FeeImmediateData: scope=ECU, multiplicity set at pre-compile, set at pre-compile, default-value=false  # Marker for high priority data. Note: Not used by Fee FlexNor. | true: Block contains immediate data. false: Block does not contain immediate data.
      integer FeeNumberOfWriteCycles: 0..10000000, multiplicity set at pre-compile, set at pre-compile  # Number of write cycles required for this block. Specifies how often the block is expected to be written during the lifetime of the ECU. This parameter is used for the endurance simulation and must therefore be carefully chosen for meaningful simulation results.
      integer FeeBlockId: 1..65535, multiplicity set at pre-compile, origin=Vector Informatik, set at pre-compile, default-value=65535  # Specifies the id of the FEE block. The block id is set when the block is created and must not be changed because otherwise the block can't be found in existing images anymore. Additionally the ids must be chosen adjacent to each other because the lookup table size is derived by the maximum block id (i.e. the higher the maximum block index, the more RAM is used).
      boolean FeeIsLookupTableBlock: multiplicity set at pre-compile, origin=Vector Informatik, set at pre-compile, default-value=false  # Determines if the block is the lookup table block for the partition. The lookup table block is used to store the current state of the lookup table in flash. The parameter is set automatically and must not be set manually.
      reference FeeDeviceIndex [0..1]: multiplicity set at pre-compile, set at pre-compile, requires-symbolic-name-value=true, destination=FlsGeneral  # Reference to the device this block is stored in. Note: Not used by Fee FlexNor.
      reference FeePartition: multiplicity set at pre-compile, origin=Vector Informatik, set at pre-compile, destination=FeePartitionConfiguration  # Reference to the partition within the FEE configuration.
      reference FeeMemAccAddressArea [0..1]: multiplicity set at pre-compile, set at pre-compile, destination=MemAccAddressAreaConfiguration  # Reference to the MemAccAddressAreaConfiguration. Not used by Fee FlexNor!
    container FeeGeneral: multiplicity set at pre-compile  # Container for general parameters. These parameters are not specific to a block.
      boolean FeeDevErrorDetect: multiplicity set at pre-compile, set at pre-compile, default-value=true  # Switches the development error detection and notification on or off. | * true: detection and notification is enabled. * false: detection and notification is disabled.
      float FeeMainFunctionPeriod: 0.0001..1, scope=ECU, multiplicity set at pre-compile, set at pre-compile, default-value=0.005  # The period between successive calls to the main function in seconds.
      function name FeeNvmJobEndNotification [0..1]: multiplicity set at pre-compile, set at pre-compile, default-value=NvM_JobEndNotification  # Mapped to the job end notification routine provided by the upper layer module (NvM_JobEndNotification).
      function name FeeNvmJobErrorNotification [0..1]: multiplicity set at pre-compile, set at pre-compile, default-value=NvM_JobErrorNotification  # Mapped to the job error notification routine provided by the upper layer module (NvM_JobErrorNotification).
      boolean FeePollingMode: multiplicity set at pre-compile, set at pre-compile, default-value=true  # Pre-processor switch to enable and disable the polling mode for this module. | true: Polling mode enabled, callback functions (provided to FLS module) disabled. false: Polling mode disabled, callback functions (provided to FLS module) enabled.
      boolean FeeSetModeSupported: multiplicity set at pre-compile, set at pre-compile, default-value=false  # Compiler switch to enable/disable the 'SetMode' functionality of the FEE module. Note: Not used by Fee FlexNor. | TRUE: SetMode functionality supported / code present, FALSE: SetMode functionality not supported / code not present. Note: This configuration setting has to be consistent with that of all underlying flash device drivers (configuration parameter FlsSetModeApi).
      boolean FeeVersionInfoApi: multiplicity set at pre-compile, set at pre-compile, default-value=false  # Pre-processor switch to enable / disable the API to read out the modules version information. | true: Version info API enabled. false: Version info API disabled.
      integer FeeVirtualPageSize: 0..65535, multiplicity set at pre-compile, set at pre-compile, default-value=0  # The size in bytes to which logical blocks shall be aligned. Note: Not used by Fee FlexNor.
      boolean FeeSafeBswChecks: multiplicity set at pre-compile, origin=Vector Informatik, set at pre-compile, default-value=true  # Selects if safety checks are used. These checks improve robustness as e.g. invalid parameters are checked before function is executed. This attribute has to be enabled for safety projects where this component is mapped to an ASIL partition.
      string FeeNvmCbkIncludeFile [0..1]: multiplicity set at pre-compile, origin=Vector Informatik, set at pre-compile, default-value=NvM_Cbk.h, max-length=32, min-length=1  # This parameter defines the name of the include file for callback functions declaration of the NvM.
      enumeration FeeMainFunctionTriggering: multiplicity set at pre-compile, origin=Vector Informatik, set at pre-compile, default-value=FixedCycleTime  # The MainFunction can be scheduled in different ways, which allows adapting the runtime behavior - FixedCycleTime: All activities are executed in the MainFunction with the defined cycle time. - BackgroundTask: Activities that do not require a fixed cycle time run in the background task. The response time of such activities will depend on the current CPU load. Note If the system is overloaded, it may happen that the background task is no longer called.
        FixedCycleTime  # Task for Fixed Cycle Time
        BackgroundTask  # Task for Background Handling
      integer FeeInternalBufferSize: 32..65536, multiplicity set at pre-compile, origin=Vector Informatik, set at pre-compile, default-value=128  # Specifies the size of the internal buffer that is used to read and write management data and block payload. A larger buffer will increase the RAM consumption but will also improve the performance by reducing the required amount of flash read and write operations when writing or copying data. The maximum performance is reached when the internal buffer size equals the aligned size of the largest configured block.
      boolean FeeBootloaderMode: multiplicity set at pre-compile, origin=Vector Informatik, set at pre-compile, default-value=false  # Switches bootloader operation mode on and off. If bootloader mode is enabled the lookup tabel size has to be configured for every partirion.
      integer FeeMinimumReadPageSize: 0..65535, multiplicity set at pre-compile, set at pre-compile, default-value=1  # Minimum Page size will be a multiple of the minimum page size. Fee shall align read requests to this size. Not used! Use the FeePartitionConfiguration/FeeReadAlignment instead.
      boolean FeeLookupTableCompatibilityMode: multiplicity set at pre-compile, origin=Vector Informatik, set at pre-compile, default-value=false  # Switches the lookup table compatibility to older Fee FlexNor versions on and off. It must be enabled, if the flash is additionally used by a Fee FlexNor (e.g. in the bootloader) which has a version below 4.01.00.
      boolean FeeReportExceptions: multiplicity set at pre-compile, origin=Vector Informatik, set at pre-compile, default-value=true  # Enables the reporting of critical errors via callback. (Detection is always enabled, independent from the setting here). When enabled and a critical error is detected, the callback void Fee_30_FlexNor_DiagnosticHandler_UserCallback(EventPublishedInfoType eventInfo) (name not configurable) will be called by the Fee. The integrator must implement the callback. The given parameter eventInfo will give some more information about the exception. It is highly recommended to keep this option enabled. Background: It is mandatory that the integrator and the hardware platform fullfil some requirements, that can be found in the Technical Reference (see chapter "Diagnostic Handler"). If these requirements are not met, the Fee is not able to work properly. So the integrator is in charge to assure, that every single requirement is met. However, if one requirement is not met, the effect will not be detectable immediately. Hence, it is quite difficult to recognize wrong integrations. Usually, they are recognized when it is already to late. In order to support the integrator, the Fee tries to detect unexpected effects which are usually caused by integration errors and can lead to data loss or unexpected behavior. In this case the Fee raises an exception. It is very important, that the source of the exception, i.e. the wrong integration, is fixed. When the FeeExceptionReporting mechanism is enabled, the Fee will notify the integrator in case an exception was detected. Depending on the error code, the integrator/tester can then get more information, what must be fixed. It is highly recommended to keep this setting enabled.
      boolean FeeReportDebugNotifications: multiplicity set at pre-compile, origin=Vector Informatik, set at pre-compile, default-value=false  # Enables the reporting of debug notifications via callback. FeeReportExceptions must be enabled, to be able to enable the reporting of debug notifications. When enabled and a job "milestone" is reached, the callback void Fee_30_FlexNor_DiagnosticHandler_UserCallback(EventPublishedInfoType eventInfo) (name not configurable) will be called by Fee. Such a milestone can be the single write steps (e.g. writing the chunk commit marker) or other operations (e.g. start of a space garbage collection...) This allows the integrator/tester to get some kind of a log, when something is not working as expected. This log will also help the Vector support to give better and faster feedback. It is recommended to keep this option disabled and enable it, when a debug scenario occurs
      reference FeeBufferAlignmentValue [0..1]: multiplicity set at pre-compile, set at pre-compile, destination=MemAccAddressAreaConfiguration  # Parameter determines the alignment of the start address that Fee buffers need to have. Not used!
      container FeeFlsApi [0..1]: multiplicity set at pre-compile  # Enabels to manually configure the interface to the underlaying flash driver. This includes the header to include as well as the used function names.
        string FeeFlsIncludeFile: multiplicity set at pre-compile, origin=Vector Informatik, set at pre-compile, default-value=Fls.h  # This parameter defines the name of the header File of the Flash Driver.
        function name FeeFlsRead: multiplicity set at pre-compile, origin=Vector Informatik, set at pre-compile, default-value=Fls_Read  # This parameter defines the name of the Flash Read API.
        function name FeeFlsWrite: multiplicity set at pre-compile, origin=Vector Informatik, set at pre-compile, default-value=Fls_Write  # This parameter defines the name of the Flash Write API.
        function name FeeFlsCancel: multiplicity set at pre-compile, origin=Vector Informatik, set at pre-compile, default-value=Fls_Cancel  # This parameter defines the name of the Flash Cancel API.
        function name FeeFlsGetStatus: multiplicity set at pre-compile, origin=Vector Informatik, set at pre-compile, default-value=Fls_GetStatus  # This parameter defines the name of the Flash GetStatus API.
        function name FeeFlsGetJobResult: multiplicity set at pre-compile, origin=Vector Informatik, set at pre-compile, default-value=Fls_GetJobResult  # This parameter defines the name of the Flash GetJobResult API.
        function name FeeFlsErase: multiplicity set at pre-compile, origin=Vector Informatik, set at pre-compile, default-value=Fls_Erase  # This parameter defines the name of the Flash Erase API.
        function name FeeFlsBlankCheck: multiplicity set at pre-compile, origin=Vector Informatik, set at pre-compile, default-value=Fls_BlankCheck  # This parameter defines the name of the Flash Blank Check API.
        string FeeFlsAddressType: multiplicity set at pre-compile, origin=Vector Informatik, set at pre-compile, default-value=Fls_AddressType  # This parameter defines the name of the Fls Address Type.
        string FeeFlsLengthType: multiplicity set at pre-compile, origin=Vector Informatik, set at pre-compile, default-value=Fls_LengthType  # This parameter defines the name of the Fls Length Type.
    container FeePublishedInformation: multiplicity set at pre-compile  # Additional published parameters not covered by CommonPublishedInformation container. | Note that these parameters do not have any configuration class setting, since they are published information.
      integer FeeBlockOverhead: 0..65535, multiplicity set at pre-compile, set at published-information in variant pre-compile / pre-compile in variant link-time, default-value=0  # Management overhead per logical block in bytes. Note: Not used by Fee FlexNor. | Note: If the management overhead depends on the block size or block location a formula has to be provided that allows the configurator to calculate the management overhead correctly.
      integer FeePageOverhead: 0..65535, multiplicity set at pre-compile, set at published-information in variant pre-compile / pre-compile in variant link-time, default-value=0  # Management overhead per page in bytes. Note: Not used by Fee FlexNor. | Note: If the management overhead depends on the block size or block location a formula has to be provided that allows the configurator to calculate the management overhead correctly.
    container FeePartitionConfiguration [1..256]: multiplicity set at pre-compile  # Configuration of partition specific parameters for the Flash EEPROM Emulation module.
      enumeration FeePartitionLayout: {SecureLayout, SlimLayout}, multiplicity set at pre-compile, origin=Vector Informatik, set at pre-compile, default-value=SecureLayout  # Memory layout used for the partition. Depending on the underlaying flash, different management layouts are used. Check the technical reference for hints on what layout to use.
      integer FeePageAlignment: 4..1024, multiplicity set at pre-compile, origin=Vector Informatik, set at pre-compile, default-value=4  # This parameter specifies the minimal amount of bytes that can be programmed by one flash write request. Fee aligns write requests to this size. This value must be equal to or a multiple of the FeeReadAlignment.
      integer FeeInterferenceFreeAlignment: 4..1024, multiplicity set at pre-compile, origin=Vector Informatik, set at pre-compile, default-value=8  # Specifies the alignment for parts of the management data. The alignment must be chosen in a way that the aligned areas don't inferfere with each other. Check the technical reference for more information on this topic.
      boolean FeeBlankCheckRequired: multiplicity set at pre-compile, origin=Vector Informatik, set at pre-compile, default-value=false  # Specifies if a blank check must be executed before acually reading the flash memory. If a blank check is required depends on the used flash device.
      integer FeeLookupTableSize: 0..65536, multiplicity set at pre-compile, origin=Vector Informatik, set at pre-compile, default-value=0  # Specifies the size of the lookup table which is used to reduce search effort for the latest valid instance of a block. If bootloader mode is enabled the lookup table size has to be preconfigured by the user. The size should be at least the number of blocks configured for this partition plus one, because one index is reserved for the lookup table block. ATTENTION: The size has to be big enough to reserve space for future application updates without needing to update the bootloader. If bootloader mode is disabled the lookup table size is determined automatically from the number of blocks and cannot be configured by the user.
      integer FeeMaximalEraseCycles: 0..4294967295, multiplicity set at pre-compile, origin=Vector Informatik, set at pre-compile, default-value=0  # Specifies the maximal allowed number of erase cycles regarding this partition. In case FeeGeneral/FeeReportExceptions is enabled the Fee will notify the user with the warnings FEE_30_FLEXNOR_DIAGID_MAX_ERASE_CYCLES_ALMOST_REACHED if 80% of the maximal value is exceeded and FEE_30_FLEXNOR_DIAGID_SECTORIDSPAN_VERYHIGH if the maximal value is exceede, The value is automatically synchronized from the lower layer. - FlsSpecifiedEraseCycles in case the PartitionTarget references a Fls driver. - MemSpecifiedEraseCycles in case the PartitionTarget references an MemAccAddressArea.
      integer FeeReadAlignment: 1..1024, multiplicity set at pre-compile, origin=Vector Informatik, set at pre-compile, default-value=1  # This parameter specifies the minimum readable unit of the underlying flash memory. Fee aligns read requests to this size.
      choice reference FeePartitionTarget: multiplicity set at pre-compile, origin=Vector Informatik, set at pre-compile, destination=[MemAccAddressAreaConfiguration, FlsConfigSet]  # Reference to either a MemAcc AddressArea or an Fls ConfigSet. Note: If the target is a MemAcc AddressArea, the FeeFlsApi container cannot be configured for the FeeGeneral container.
      container FeeSectorConfiguration [2..32]: multiplicity set at pre-compile  # Configuration of the logical sectors assigned to the partition. A logical sector is made from 1:n physical flash sectors and is used to divide the available flash memory for the partition into parts that can be garbage collected separately. More information can be found in the technical reference documentation.
        integer FeeSectorAddress: 0..4294967295, multiplicity set at pre-compile, origin=Vector Informatik, set at pre-compile, default-value=0  # Start address of the sector. The FEE expects the same address space that is exposed by the flash driver.
        integer FeeSectorSize: 0..2147483648, multiplicity set at pre-compile, origin=Vector Informatik, set at pre-compile, default-value=1024  # Size of the logical sector in bytes. It is recommended that all logical sectors of a partition are configured to be equal in size.
  bsw implementation Fee_Impl: programming-language=C, sw-version=4.04.01, used-code-generator=DaVinci Configurator, vendor-id=30, ar-release-version=4.08.00, behavior=Fee_30_FlexNorBehavior, preconfigured-configuration=Fee_Pre, recommended-configuration=Fee_Rec, vendor-api-infix=FlexNor, vendor-specific-module-def=Fee
  module config Fee_Pre: definition=Fee
  module config Fee_Rec: definition=Fee
