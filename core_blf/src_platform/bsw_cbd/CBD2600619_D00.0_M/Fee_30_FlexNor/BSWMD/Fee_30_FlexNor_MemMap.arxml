AUTOSAR XML (schema 00048)
# COPYRIGHT
# Copyright (c) 2023 by Vector Informatik GmbH. All rights reserved.
# This software is copyright protected and proprietary to Vector Informatik GmbH.
# Vector Informatik GmbH grants to you only those rights as set out in the license conditions.
package /MICROSAR/Fee_30_FlexNor
  bsw implementation Fee_Impl
    required-artifacts:
      dependency on artifact Fee_30_FlexNor_MemMap: category=MEMMAP, artifact-descriptor={short-label=Fee_30_FlexNor_MemMap.h, category=SWHDR}
    resource consumption ResourceConsumption
      10 x memory section:
        FEE_30_FLEXNOR_CODE: sw-addrmethod=CODE, symbol=CODE
        FEE_30_FLEXNOR_CONST_32: alignment=32, sw-addrmethod=CONST, symbol=CONST_32
        FEE_30_FLEXNOR_CONST_UNSPECIFIED: alignment=UNSPECIFIED, sw-addrmethod=CONST, symbol=CONST_UNSPECIFIED
        FEE_30_FLEXNOR_VAR_NO_INIT_8: alignment=8, sw-addrmethod=VAR_NO_INIT, symbol=VAR_NO_INIT_8
        FEE_30_FLEXNOR_VAR_NO_INIT_32: alignment=32, sw-addrmethod=VAR_NO_INIT, symbol=VAR_NO_INIT_32
        FEE_30_FLEXNOR_VAR_NO_INIT_UNSPECIFIED: alignment=UNSPECIFIED, sw-addrmethod=VAR_NO_INIT, symbol=VAR_NO_INIT_UNSPECIFIED
        FEE_30_FLEXNOR_VAR_INIT_32: alignment=32, sw-addrmethod=VAR_INIT, symbol=VAR_INIT_32
        FEE_30_FLEXNOR_VAR_INIT_UNSPECIFIED: alignment=UNSPECIFIED, sw-addrmethod=VAR_INIT, symbol=VAR_INIT_UNSPECIFIED
        FEE_30_FLEXNOR_VAR_CLEARED_8: alignment=8, sw-addrmethod=VAR_CLEARED, symbol=VAR_CLEARED_8
        FEE_30_FLEXNOR_VAR_CLEARED_UNSPECIFIED: alignment=UNSPECIFIED, sw-addrmethod=VAR_CLEARED, symbol=VAR_CLEARED_UNSPECIFIED
