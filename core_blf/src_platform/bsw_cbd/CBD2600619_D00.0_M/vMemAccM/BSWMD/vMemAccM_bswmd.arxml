AUTOSAR XML (schema 4-0-3)
# COPYRIGHT
# Copyright (c) 2025 by Vector Informatik GmbH. All rights reserved.
# This software is copyright protected and proprietary to Vector Informatik GmbH.
# Vector Informatik GmbH grants to you only those rights as set out in the license conditions.
package /MICROSAR
  bsw implementation vMemAccM_Impl: programming-language=C, sw-version=7.05.01, used-code-generator=DaVinci Configurator, vendor-id=30, behavior=vMemAccMBehavior, preconfigured-configuration=vMemAccM_Pre, recommended-configuration=vMemAccM_Rec, vendor-specific-module-def=vMemAccM
  module definition vMemAccM [0..1]: category=VENDOR_SPECIFIC_MODULE_DEFINITION, variants pre-compile  # Memory Access Manager | The vMemAccM (Memory Access Manager) coordinates the NV (non volatile) memory access by multiple users in order to avoid conflicts with this shared resource. The module abstracts from the NV RAM device specific addressing scheme and provides the upper layers with a virtual addressing scheme. #NVRAM #NVMemory #Memory #DataStorage #MICROSAR
    container vMemAccMGeneral  # General configuration parameters of the vMemAccM.
      boolean vMemAccMVersionInfoApi: set at pre-compile, origin=Vector Informatik, default-value=false  # This parameter enables/disables the function vMemAccM_GetVersionInfo() to get major, minor and patch version information.
      float vMemAccMMainFunctionPeriod: 0.0001..1, set at pre-compile, origin=Vector Informatik, default-value=0.005  # This value specifies the fixed call cycle for vMemAccM_MainFunction(). Additionally, if a job is ongoing on a vMem, the underlying vMem MainFunction will be triggered directly by vMemAccM at this fixed call cycle. This information affects RTE's (SchM's) settings. vMemAccM itself does not depend on a fixed cycle time; in can be triggered at arbitrary rates. The faster you want vMemAccM_MainFunction being triggered, the smaller this value should be and vice versa.
      enumeration vMemAccMMainFunctionTriggering: set at pre-compile, origin=Vector Informatik, default-value=FixedCycleTime  # This parameter defines the way how vMemAccM_MainFunction() is called. The vMemAccM_MainFunction() can be scheduled in different ways, which allows adapting the runtime behavior - FixedCycleTime: All activities are executed in the vMemAccM_MainFunction() with the defined cycle time. - BackgroundTask: Activities that do not require a fixed cycle time run in the background task. The response time of such activities will depend on the current CPU load. Note If the system is overloaded, it may happen that the background task is no longer called.
        FixedCycleTime  # Task for Fixed Cycle Time
        BackgroundTask  # Background Task
      boolean vMemAccMSafeBswChecks: set at pre-compile, origin=Vector Informatik, default-value=true  # This parameter defines if safety checks are used. These checks improve robustness as e.g. invalid parameters are checked before function is executed. This attribute has to be enabled for safety projects where this component is mapped to an ASIL partition.
      boolean vMemAccMDevErrorDetect: set at pre-compile, origin=Vector Informatik, default-value=true  # This parameter switches the Development Error Detection and Notification ON or OFF. true: Development error detection is enabled. false: Development error detection is disabled. Note: In general, the development error detection is recommended during pre-test phase. It is not recommended to enable the development error detection in production code due to increased runtime and ROM needs.
      boolean vMemAccMCompareApi: set at pre-compile, origin=Vector Informatik, default-value=false  # This parameter enables/disables the function vMemAccM_Compare(). This function allows to compare data stored in a buffer with data stored in memory.
      boolean vMemAccMUseDownloadableVMem [0..1]: set at pre-compile, origin=Vector Informatik, default-value=false  # This parameter enables/disables the usage of alternate vMems, which were obtained during runtime. true: Alternate vMems can be activated during runtime false: Alternate vMems cannot be activated during runtime Note: In general this feature is not needed, only use it if vMems need to be obtained during runtime to perform special actions.
      boolean vMemAccMMinimalSync [0..1]: set at pre-compile, origin=Vector Informatik, default-value=false  # This parameter enables/disables the usage of the minimal synchronous vMemAccM. true: minimal vMemAccM is used and therefore just the basic functionality is available which is processed synchronously. More information can be found in the Doc_TechRef. false: the vMemAccM with the whole feature set is available. Note: In general this switch can be set to false. Only switch it to true in case integration to low size ROM areas, e.g. together with vHsmUpd is required.
    container vMemAccMAddressAreaConfiguration [1..65536]  # This container includes the configuration of AddressArea specific parameters for the vMemAccM module. An AddressArea is a virtual area of memory. Upper layers only use virtual addresses to access the address area. It is the job of vMemAccM to map between virtual and physical addresses. An AddressArea contains SubAddressAreas and each SubAddressArea is part of a physically continuous memory area (sector batch)
      integer vMemAccMAddressAreaId: 0..65535, set at pre-compile, origin=Vector Informatik, symbolic-name-value=true, default-value=0  # This value specifies a unique identifier which is used to reference to an AddressArea. This identifier is used as parameter for vMemAccM jobs in order to distinguish between several AddressAreas with the same virtual addresses.
      integer vMemAccMAddressAreaPriority: 0..65535, set at pre-compile, origin=Vector Informatik, default-value=0  # This value specifies the priority of an AddressArea compared to other AddressAreas. For each AddressArea one job may be pending at the same time. vMemAccM processes the jobs prioriry based. This priority even works preemptive. Higher priority jobs pause lower priority jobs in a non-destructive manner. Whereas 0 is the lowest priority, 65535 is the highest priority. It is furthermore not allowed for two AddressAreas to have the same priority.
      integer vMemAccMReadRequestLength: 8..4096, set at pre-compile, origin=Vector Informatik, default-value=64  # This value specifies the maximum number of bytes the vMemAccM module requests within one vMem read request. Higher values might block jobs on AddressAreas even with higher priority because current vMem job must be finished before a job on another AddressArea can be started. Lower values might lead to a decreased performance, because more MainFunctionCycles (vMemAccM and vMem) are needed. Therefore this value has to be choosen with care!
      string vMemAccMJobNotification [0..1]: set at pre-compile, origin=Vector Informatik  # Parameter that enables job end notifications for the vMemAccM. The value of this parameter must be the name of the function which shall be called upon job completion.
      string vMemAccMJobNotificationHeader [0..1]: set at pre-compile, origin=Vector Informatik  # Parameter that specifies the name of the header file which contains the callback function which will be called upon job completion of the address area. The header file must contain a function with the following format: void <configuredName> (vMemAccM_AddressAreaIdType AddressAreaId, vMemAccM_JobResultType result) The name is configured through the vMemAccMJobNotification parameter.
      container vMemAccMSubAddressAreaConfiguration [1..65536]  # This container includes the configuration parameters for a physically continous area of memory.
        integer vMemAccMNumberOfSectors: 1..4294967296, set at pre-compile, origin=Vector Informatik, default-value=1  # This value specifies the number of physical sectors of this Sub-AddressArea.
        integer vMemAccMVirtualStartAddress: 0..4294967295, set at pre-compile, origin=Vector Informatik, default-value=0  # This value specifies the virtual start address of this Sub-AddressArea.
        integer vMemAccMPhysicalStartAddress: 0..4294967295, set at pre-compile, origin=Vector Informatik, default-value=0  # This value specifies the physical start address of this Sub-AddressArea.
        string vMemAccMvMemFuncPtrTableSymbol: set at pre-compile, origin=Vector Informatik  # The symbol of the vMem function pointer table the vMemAccM uses to access the specific vMem API. vMemAccM expects this symbol to be provided by the specific vMem. The symbol may be changed by user, if necessary.
        boolean vMemAccMUseEraseBurst: set at pre-compile, origin=Vector Informatik, default-value=false  # This parameter enables the erase bursting for the related sub address area. Use case: the vMem may be burst capable, but the user does not want the vMemAccM to burst, because of too long burst durations.
        boolean vMemAccMUseWriteBurst: set at pre-compile, origin=Vector Informatik, default-value=false  # This parameter enables the write bursting for the related sub address area. Use case: the vMem may be burst capable, but the user does not want the vMemAccM to burst, because of too long burst durations.
        integer vMemAccMNrOfWriteRetries [0..1]: 0..255, set at pre-compile, origin=Vector Informatik, default-value=0  # This value specifies the number of retries of a failed write job. == 0: no retry, a failed job will be aborted immediately > 0: retry the number of times before aborting the job.
        integer vMemAccMNrOfEraseRetries [0..1]: 0..255, set at pre-compile, origin=Vector Informatik, default-value=0  # This value specifies the number of retries of a failed erase job. == 0: no retry, a failed job will be aborted immediately > 0: retry the number of times before aborting the job.
        boolean vMemAccMConfigPointerUsed [0..1]: set at pre-compile, origin=Vector Informatik, default-value=false  # This parameter enables/disables the usage of ConfigPointer during vMem initialization. true: ConfigPointer is used and ConfigPointerTable is generated false: ConfigPointer is not used Note: In general this feature is not needed, only use it if vMemAccM shall support downloadable external vMem drivers.
        reference vMemAccMSectorRef: set at pre-compile, origin=Vector Informatik, destination=vMemSector  # Reference to vMem's sector batch where the Sub-AddressArea is located.
      container vMemAccMAddressAreaVariantConfiguration [0..2]  # This container includes all sub address areas belonging to the one specific address area variant.
        integer vMemAccMAddressAreaVariantId: 0..1, set at pre-compile, origin=Vector Informatik, symbolic-name-value=true, default-value=0  # This value specifies a unique identifier which is used to reference to an AddressAreaVariant. The value will be used to set the currently active variant.
        reference vMemAccMSubAddressAreaRef [1..65535]: set at pre-compile, origin=Vector Informatik, destination=vMemAccMSubAddressAreaConfiguration  # References to all SubAddressAreas relevant for this variant.
    container vMemAccMMultiPartitionConfiguration [0..1]  # This container stores all configuration values required for a vMemAccM multi partition synchronization.
      enumeration vMemAccMMultiPartitionUsecase: set at pre-compile, origin=Vector Informatik, default-value=SynchronizeMultipleNVRAMAccessors  # This parameter describes the current use case of the vMemAccM multi partition synchronization: SynchronizeMultipleNVRAMAccessor: each partition accesses the NV RAM peripheral on its own, the accesses need to be synchronized. SynchronizeSingleNVRAMAccessor: only one partition is allowed to access the NV RAM, all others need to publish their jobs to that partition. It will then process all of them sequentially.
        SynchronizeMultipleNVRAMAccessors  # Synchronize multiple NV RAM accessors
        SynchronizeSingleNVRAMAccessor  # Synchronize multiple to single NV RAM accessor
      container vMemAccMPartitionConfiguration [1..16]  # This container holds all required vMemAccM partition configuration parameters. All of the partition containers act as slaves within the multi partition system - each NV RAM access requires interaction with master to get the NV RAM access right or even the job processed. The actual behavior depends on selected multi partition use case.
        integer vMemAccMPartitionId: 1..253, set at pre-compile, origin=Vector Informatik, symbolic-name-value=true, default-value=253  # This parameter defines the unique partition identifier. The value range is [1, 16]. 0 is reserved for the master partition. [254, 255] are reserved for internal usage.
        string vMemAccMNVRAMAccessToken: set at pre-compile, origin=Vector Informatik, default-value=vMemAccM_NVRAMAccessToken  # This parameter defines the address of the NV RAM access token in shared RAM. The vMemAccM master defines and writes the variable with the symbol vMemAccM_NVRAMAccessToken. The other partions must not modify the token. The address can be specified either as a valid decimal (1024) or hexadecimal (0x4000) value, or as a valid linker symbol. Caution: The address must be 4 bytes aligned.
        string vMemAccMPartitionPublishRequest: set at pre-compile, origin=Vector Informatik  # This parameter defines the address of the variable holding the published partition request in shared RAM. The vMemAccM master defines the variable with the symbol vMemAccM_PublishReq_<SlaveName>_Id<SlaveId>. The address can be specified either as a valid decimal (1024) or hexadecimal (0x4000) value, or as a valid linker symbol. Caution: The address must be 4 bytes aligned.
        string vMemAccMPartitionData: set at pre-compile, origin=Vector Informatik  # This parameter defines the start address of the buffer where job data will be placed. The address needs to be the address where the master partition places its buffer. If the hardware uses address translation between cores, the address needs to be adapted by the addressing scheme used by the satellite partition. The parameter is only relevant in the use case of a single partition satellite. The address can be specified either as a valid decimal (1024) or hexadecimal (0x4000) value, or as a valid linker symbol. Caution: The address must be 4 bytes aligned.
      container vMemAccMMasterPartitionConfiguration [0..1]  # This container holds all required vMemAccM master partition configuration parameters. The container defines the master partition synchronizing the NV RAM accesses of all other partitions. Depending on use case the master synchronizes the NV RAM access between partitions, or even processes the partition jobs.
        integer vMemAccMMasterPartitionId: 0..0, set at pre-compile, origin=Vector Informatik, default-value=0  # This parameter defines the unique master partition identifier - always 0. [1, 253] are reserved for slave partitions. [254, 255] are reserved for internal usage.
    container vMemAccMSynchronizationGroupConfiguration [0..255]  # This container represents one synchronization group. This container references sub address areas with same synchronization affiliation. If only one container is configured, vMemAccM will behave the same as without the container - one single synchronization group, all NV RAM accesses must be synchronized. With multiple groups, multiple NV RAM accesses are possible in parallel. Please see the vMemAccM technical reference for more information about the NV RAM access synchronization.
      integer vMemAccMSynchronizationGroupId: 0..65535, set at pre-compile, origin=Vector Informatik, symbolic-name-value=true, default-value=0  # This value specifies an unique identifier which is used to reference to a synchronization group. The value is used within vMemAccM internally.
      reference vMemAccMSynchronizationSubAddressAreaRef [1..65535]: set at pre-compile, origin=Vector Informatik, destination=vMemAccMSubAddressAreaConfiguration  # References to all SubAddressAreas relevant for this synchronization group.
  module config vMemAccM_Pre: definition=vMemAccM
  module config vMemAccM_Rec: definition=vMemAccM
