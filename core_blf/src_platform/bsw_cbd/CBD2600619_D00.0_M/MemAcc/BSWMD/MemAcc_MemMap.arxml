AUTOSAR XML (schema 00048)
# COPYRIGHT
# Copyright (c) 2025 by Vector Informatik GmbH. All rights reserved.
# This software is copyright protected and proprietary to Vector Informatik GmbH.
# Vector Informatik GmbH grants to you only those rights as set out in the license conditions.
package /MICROSAR
  bsw implementation MemAcc_Impl
    required-artifacts:
      dependency on artifact MemAcc_MemMap: category=MEMMAP, artifact-descriptor={short-label=MemAcc_MemMap.h, category=SWHDR}
    resource consumption ResourceConsumption
      7 x memory section:
        MEMACC_CODE: sw-addrmethod=CODE, symbol=CODE
        MEMACC_CONST_UNSPECIFIED: alignment=UNSPECIFIED, sw-addrmethod=CONST, symbol=CONST_UNSPECIFIED
        MEMACC_CONST_8: alignment=8, sw-addrmethod=CONST, symbol=CONST_8
        MEMACC_VAR_CLEARED: sw-addrmethod=VAR_CLEARED, symbol=VAR_CLEARED
        MEMACC_VAR_NO_INIT_UNSPECIFIED: alignment=UNSPECIFIED, sw-addrmethod=VAR_NO_INIT, symbol=VAR_NO_INIT_UNSPECIFIED
        MEMACC_VAR_INIT_UNSPECIFIED: alignment=UNSPECIFIED, sw-addrmethod=VAR_INIT, symbol=VAR_INIT_UNSPECIFIED
        MEMACC_VAR_NOCACHE_INIT_UNSPECIFIED: alignment=UNSPECIFIED, sw-addrmethod=VAR_NOCACHE_INIT, symbol=VAR_NOCACHE_INIT_UNSPECIFIED
