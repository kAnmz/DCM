AUTOSAR XML (schema 00052)
# COPYRIGHT
# Copyright (c) 2026 by Vector Informatik GmbH. All rights reserved.
# This software is copyright protected and proprietary to Vector Informatik GmbH.
# Vector Informatik GmbH grants to you only those rights as set out in the license conditions.
package /MICROSAR
  module definition MemAcc [0..1]: category=VENDOR_SPECIFIC_MODULE_DEFINITION, refined-module-def=MemAcc, variants pre-compile  # The MemAcc (Memory Access module) coordinates the memory access by multiple users in order to avoid conflicts with this shared memory resource. #NVRAM #NVMemory #Memory #DataStorage #AUTOSAR | The module abstracts from the memory device specific addressing scheme and provides a logical addressing scheme to the upper layer.
    container MemAccAddressAreaConfiguration [1..65535]: multiplicity set at pre-compile, post-build-variant-multiplicity=true  # This container includes the configuration of AddressArea specific parameters for the MemAcc module. | An AddressArea is a logical area of memory. Upper layers only use logical addresses to access the address area. It is the job of MemAcc to map between logical and physical addresses. An AddressArea contains SubAddressAreas and each SubAddressArea is part of a physically continuous memory area (sector batch).
      integer MemAccAddressAreaId: 0..65535, multiplicity set at pre-compile, set at pre-compile, symbolic-name-value=true, default-value=0  # This value specifies a unique identifier which is used to reference to an AddressArea. | This identifier is used as parameter for MemAcc jobs in order to distinguish between several AddressAreas with the same logical addresses.
      integer MemAccAddressAreaPriority: 0..65535, multiplicity set at pre-compile, post-build-variant-value=true, set at pre-compile, default-value=0  # This value specifies the priority of an AddressArea compared to other AddressAreas (0 = lowest priority, 65535 = highest priority). | For each AddressArea only one job can be processed at a time. MemAcc processes the jobs priority based. In case a job with a higher priority is requested by an upper layer, the lower priority jobs are suspended until the higher priority job is completed.
      integer MemAccBufferAlignmentValue: 0..4294967295, multiplicity set at pre-compile, set at pre-compile  # Buffer alignment value inherited by MemAcc upper layer modules. The value must be a multiple of MinReadSize.
      function name MemAccJobEndNotificationName: multiplicity set at pre-compile, set at pre-compile, default-value=NULL_PTR  # Job end notification function which is called after MemAcc job completion. If no job end notification is intended to be used, the upper layer module needs to poll the job results and this value shall be set to NULL_PTR.
      function name MemAccErrorNotificationName: multiplicity set at pre-compile, origin=Vector Informatik, set at pre-compile, default-value=NULL_PTR  # Error notification function which is called in case of a critical error. If at least one SubAddressArea of the AddressArea targets a MemInstance of a Vector Mem driver for NAND flash, this error callback has to be configured and will be called in case of a critical error during bad block management. Otherwise, this value can be set to NULL_PTR. For more information see technical reference.
      container MemAccSubAddressAreaConfiguration [1..65536]: multiplicity set at pre-compile, post-build-variant-multiplicity=true  # This container includes the configuration parameters for a physically continuous area of memory.
        integer MemAccLogicalStartAddress: 0..18446744073709551615, multiplicity set at pre-compile, post-build-variant-value=true, set at pre-compile, default-value=0  # This value specifies the logical start address of the SubAddressArea.
        enumeration MemAccMemInvocation: {DIRECT_STATIC, INDIRECT_DYNAMIC, INDIRECT_STATIC}, multiplicity set at pre-compile, set at pre-compile, default-value=DIRECT_STATIC  # Defines how the Mem driver services are accessed and how the Mem driver is scheduled and activated/initialized. DIRECT_STATIC: Mem driver will be accessed directly. Mem will not be initialized and triggered by MemAcc. INDIRECT_STATIC: Mem driver will be accessed indirectly via a function pointer table. Mem will be initialized and triggered by MemAcc. INDIRECT_DYNAMIC: Mem can only be accessed after explicit activation. Mem will be initialized and triggered by MemAcc. See technical reference for more details.
        string MemAccMemNamePrefix: multiplicity set at pre-compile, set at pre-compile, min-length=1  # This prefix is either used to reference the Mem driver header structure or the according Mem API function.
        integer MemAccNumberOfEraseRetries: 0..255, multiplicity set at pre-compile, post-build-variant-value=true, set at pre-compile, default-value=0  # This value specifies the number of retries of a failed erase job. | 0: No retry, a failed job will be aborted immediately > 0: Retry the number of times before aborting the job.
        integer MemAccNumberOfSectors: 1..4294967295, multiplicity set at pre-compile, post-build-variant-value=true, set at pre-compile, default-value=1  # This value specifies the number of physical sectors of the SubAddressArea.
        integer MemAccNumberOfWriteRetries: 0..255, multiplicity set at pre-compile, post-build-variant-value=true, set at pre-compile, default-value=0  # This value specifies the number of retries of a failed write job. | 0: No retry, a failed job will be aborted immediately > 0: Retry the number of times before aborting the job.
        integer MemAccSectorOffset: 0..4294967295, multiplicity set at pre-compile, post-build-variant-value=true, set at pre-compile, default-value=0  # This value specifies the sector offset of the SubAddressArea in case the SubAddressArea should not start with the first sector of the referenced MemSectorBatch.
        boolean MemAccUseEraseBurst: multiplicity set at pre-compile, post-build-variant-value=true, set at pre-compile, default-value=false  # This parameter enables erase bursting for the related sub address area.
        boolean MemAccUseWriteBurst: multiplicity set at pre-compile, post-build-variant-value=true, set at pre-compile, default-value=false  # This parameter enables write bursting for the related sub address area.
        integer MemAccNumberOfReadRetries: 0..255, multiplicity set at pre-compile, origin=Vector Informatik, set at pre-compile, default-value=0  # This value specifies the number of retries of a failed read and compare job.
        reference MemAccSectorBatchRef: multiplicity set at pre-compile, post-build-variant-value=true, set at pre-compile, destination=MemSectorBatch  # Reference to MemSectorBatch mapped to the SubAddressArea. Note for multi binary use case: If this MemAcc is configured as a satellite and requests to this SubAddress should be forwarded to a MemAcc master, only a reference to a dummy Mem driver should be set which should imitate the real Mem on the MemAcc master. See technical reference for more information.
    container MemAccGeneral: multiplicity set at pre-compile  # General configuration parameters of the MemAcc.
      boolean MemAcc64BitSupport: multiplicity set at pre-compile, set at pre-compile, default-value=false  # This option enables 64-bit support. If disabled, the software will operate in 32-bit mode.
      boolean MemAccCompareApi: multiplicity set at pre-compile, set at pre-compile, default-value=false  # This parameter enables/disables the function MemAcc_Compare(). | This function allows to compare data stored in a buffer with data stored in memory.
      boolean MemAccDevErrorDetect: multiplicity set at pre-compile, set at pre-compile, default-value=true  # Switches the development error detection and notification on or off.
      float MemAccMainFunctionPeriod: 0..1.7976931348623157E+308, multiplicity set at pre-compile, set at pre-compile  # This value specifies the fixed call cycle for MemAcc_MainFunction(). | Additionally, if a job is ongoing on a Mem and INDIRECT_DYNAMIC or INDIRECT_STATIC mode is used, the underlying Mem_MainFunction will be triggered directly by MemAcc at this fixed call cycle. MemAcc does not depend on a fixed cycle time; it can be triggered at arbitrary rates.
      string MemAccPublicCddHeaderFile [0..*]: multiplicity set at pre-compile, set at pre-compile, max-length=32, min-length=1  # Defines header files for callback functions which shall be included in case of CDDs. Range of characters is 1.. 32.
      boolean MemAccUseMemFuncPtrTable: multiplicity set at pre-compile, set at pre-compile, default-value=true  # Not supported! For each Mem, the usage of the Mem function pointer table is seperately decided according to its configured Invocation type: For DIRECT_STATIC Mems functions are called directly. For INDIRECT_STATIC/DYNAMIC Mems functions are called using the Mem function pointer table API.
      boolean MemAccSafeBswChecks: multiplicity set at pre-compile, origin=Vector Informatik, set at pre-compile, default-value=false  # Safe BSW Checks | This parameter selects if safety checks are used. These checks improve robustness as e.g. invalid parameters are checked before function is executed. This attribute has to be enabled for safety projects where this component is mapped to an ASIL partition.
      enumeration MemAccMainFunctionTriggering: multiplicity set at pre-compile, origin=Vector Informatik, set at pre-compile, default-value=FixedCycleTime  # This parameter defines the way how MemAcc_MainFunction() is called. The MemAcc_MainFunction() can be scheduled in different ways, which allows adapting the runtime behavior - FixedCycleTime: All activities are executed in the MemAcc_MainFunction() with the defined cycle time. - BackgroundTask: Activities that do not require a fixed cycle time run in the background task. The response time of such activities will depend on the current CPU load. Note If the system is overloaded, it may happen that the background task is no longer called.
        FixedCycleTime  # Task for Fixed Cycle Time
        BackgroundTask  # Background Task
      boolean MemAccSuspendResumeEnabled: multiplicity set at pre-compile, origin=Vector Informatik, set at pre-compile, default-value=true  # This parameter defines wether the Suspend/Resume feature is enabled. Enable this feature if the used Mems provide these services with a standard return value and not with a void return value. The signature of these Mem functions was fixed with AUTOSAR 24-11.
      boolean MemAccReadCompareAlignmentRequired: multiplicity set at pre-compile, origin=Vector Informatik, set at pre-compile, default-value=true  # This parameter defines whether address and length alignment is required for MemAcc_Read() and MemAcc_Compare() requests. Setting the switch to true means the AUTOSAR alignment requirement is active.The caller of ``MemAcc_Read`` and ``MemAcc_Compare`` must ensure that the address and length are aligned to ``MemMinReadSize``. Setting the switch to false means the MemAcc accepts read and compare requests with arbitrary addresses and lengths and handles the alignment internally. As a trade off additional RAM is required and overall processing time may increase. | Disabling this requirement is a deviation from the AUTOSAR standard. When disabled, MemAcc transparently handles alignment internally so that the Mem driver always receives aligned requests. This may result in a larger read range than originally requested by the caller.
    container MemAccSynchronizationGroupConfiguration [0..65535]: multiplicity set at pre-compile, post-build-variant-multiplicity=true  # This container represents one synchronization group. This container references sub address areas with the same synchronization affiliation. If only one container is configured, MemAcc will behave the same as without the container - one single synchronization group, all Mem accesses must be synchronized. With multiple groups, multiple Mem accesses are possible in parallel. Please see the MemAcc technical reference for more information about the Mem access synchronization.
      integer MemAccSynchronizationGroupId: 0..65535, multiplicity set at pre-compile, origin=Vector Informatik, post-build-variant-value=true, set at pre-compile, default-value=0  # This value specifies a unique identifier which is used to reference to a synchronization group. The value is used within MemAcc internally.
      reference MemAccSynchronizationSubAddressAreaRef [1..65535]: multiplicity set at pre-compile, origin=Vector Informatik, post-build-variant-value=true, set at pre-compile, destination=MemAccSubAddressAreaConfiguration  # References to all SubAddressAreas relevant for this synchronization group.
    choice container MemAccMultiBinaryConfiguration [0..1]: multiplicity set at pre-compile, origin=Vector Informatik  # This choice container stores all configuration values required for a MemAcc multi binary synchronization.
      container MemAccMasterConfiguration [0..1]: multiplicity set at pre-compile, origin=Vector Informatik  # This container holds all required MemAcc master configuration parameters. The container defines the master synchronizing the NV RAM accesses of all other satellites. Depending on configuration the master synchronizes the NV RAM access between master and satellites, or even processes the satellite jobs.
        integer MemAccMasterId: 0..0, multiplicity set at pre-compile, origin=Vector Informatik, set at pre-compile, default-value=0  # This parameter defines the unique master identifier - always 0. [1, 15] are reserved for satellite binaries.
        container MemAccMultiBinarySynchronizationGroupConfiguration: multiplicity set at pre-compile  # The exact memory which shall be synchronized by the master can be configured. By default, if the reference parameter MemAccRelevantSynchronizationGroups is not configured, all SubAddressAreas (== all Mem drivers) will be synchronized by master.
          integer MemAccNumberOfSatellites: 1..15, multiplicity set at pre-compile, origin=Vector Informatik, set at pre-compile  # This parameter defines the amount of satellites considered by the master. Caution: The MemAccSatelliteId within the MemAcc satellites configuration must be set accordingly, e.g. amount is 2 then there must be satellites configured with Id 1 and 2.
          reference MemAccRelevantSynchronizationGroup [0..1]: multiplicity set at pre-compile, origin=Vector Informatik, set at pre-compile, destination=MemAccSynchronizationGroupConfiguration  # With this reference parameter it can be distinguish which memory accesses should be synchronized by master. For example, two synchronization groups are configured one accessing the internal memory which shall be synchronized by master and one accessing external memory which does not need to be synchronized by master. By setting here the reference to the synchronization group accessing internal memory only this memory will be considered for multi binary synchronization. By default, if MemAccRelevantSynchronizationGroups is not configured, all SubAddressAreas (== all Mem drivers) will be synchronized by master.
          container MemAccRedirectedMemRequestConfiguration [0..65536]: multiplicity set at pre-compile, origin=Vector Informatik  # If a MemAcc satellite redirect requests to the master the Sector Batch of the targeted Mem driver must be configured here. It must be ensured that the referenced MemSectorBatch configuration here in the master is the same as referenced within the satellite MemAcc.
            integer MemAccRedirectedMemSateliteId: multiplicity set at pre-compile, origin=Vector Informatik, set at pre-compile  # Id of the satellite which redirects requests to the configured MemSectorBatches.
            reference MemAccRedirectedMemRequestSectorBatchRef [1..65535]: multiplicity set at pre-compile, origin=Vector Informatik, set at pre-compile, destination=MemSectorBatch  # Reference to MemSectorBatch used by the MemAcc satellite.
      container MemAccSatelliteConfiguration [0..1]: multiplicity set at pre-compile, origin=Vector Informatik  # This container holds all required MemAcc satellite configuration parameters.
        integer MemAccSatelliteId: 1..15, multiplicity set at pre-compile, origin=Vector Informatik, set at pre-compile  # This parameter defines the unique binary identifier. The value range is [1, 15]. 0 is reserved for the master binary.
        container MemAccMultiBinarySynchronizationGroupConfiguration: multiplicity set at pre-compile, origin=Vector Informatik  # Within this container the placement of the shared RAM structures provided by the MemAcc master is published to this MemAcc satellite. Also the exact memory which shall be synchronized by the master can be configured. By default, if the reference parameter MemAccRelevantSynchronizationGroups is not configured, all SubAddressAreas (== all Mem drivers) will be synchronized by master,
          string MemAccAccessToken: multiplicity set at pre-compile, origin=Vector Informatik, set at pre-compile, default-value=MemAcc_MultiBinary_SynchronizationToken  # This parameter defines the address of the NV RAM access token in shared RAM. The MemAcc master defines and writes the variable with the symbol MemAcc_MultiBinary_SynchronizationToken. The access token is specified as a valid linker symbol. This field is for information only.
          string MemAccPublishRequest: multiplicity set at pre-compile, origin=Vector Informatik, set at pre-compile, default-value=MemAcc_MultiBinary_AccessRequestSatellite_Id<SatelliteId>  # This parameter defines the address of the variable holding the published satellite request in shared RAM. The MemAcc master defines the variable with the symbol MemAcc_MultiBinary_AccessRequestSatellite_Id<SatelliteId>. This field is for information only.
          reference MemAccRelevantSynchronizationGroup [0..1]: multiplicity set at pre-compile, origin=Vector Informatik, set at pre-compile, destination=MemAccSynchronizationGroupConfiguration  # With this reference parameter it can be distinguish which memory accesses should be synchronized by master. For example, two synchronization groups are configured one accessing the internal memory which shall be synchronized by master and one accessing external memory which does not need to be synchronized by master. By setting here the reference to the synchronization group accessing internal memory only this memory will be considered for multi binary synchronization. By default, if MemAccRelevantSynchronizationGroups is not configured, all SubAddressAreas (== all Mem drivers) will be synchronized by master,
          reference MemAccRedirectedMemRequests [0..65535]: multiplicity set at pre-compile, origin=Vector Informatik, set at pre-compile, destination=MemAccSubAddressAreaConfiguration  # References to all SubAddressAreas for which requests shall be redirected to the MemAcc master.
    container MemAccReadOnlyModeConfiguration [0..65535]: multiplicity set at pre-compile, origin=Vector Informatik, post-build-variant-multiplicity=true  # This container includes the configuration of read-only mode specific parameters for the MemAcc module. With this parameters MemAcc is able to put a memory area into full mode, which was set in read-only mode by default. In read-only mode the configured memory area is protected against writing and erasing.
      string MemAccUnlockTokenValue: multiplicity set at pre-compile, origin=Vector Informatik, set at pre-compile, min-length=4  # This parameter defines the value of unlock token against which is checked. A signed unlock token is downloaded in case the memory area shall be switched in full mode.
      boolean MemAccReadOnlyModeSupportsHwSpecificService: multiplicity set at pre-compile, origin=Vector Informatik, set at pre-compile, default-value=true  # This parapeter specifies if the HwSpecific service can be used in read-only mode. TRUE: the HwSpecific service can be used in read-only mode. FALSE: the HwSpecific service can be only used in full mode.
      reference MemAccMemInstanceLockRef: multiplicity set at pre-compile, origin=Vector Informatik, set at pre-compile, destination=MemInstance  # This reference parameter represents the MemInstance which shall be put into read-only mode.
      reference MemAccAddressAreaLockRef [1..65535]: multiplicity set at pre-compile, origin=Vector Informatik, set at pre-compile, destination=MemAccAddressAreaConfiguration  # This reference parameter represens the Address Area which shall be put into read-only mode.
  bsw implementation MemAcc_Impl: programming-language=C, sw-version=3.05.00, used-code-generator=DaVinci Configurator, vendor-id=30, ar-release-version=4.10.00, behavior=MemAccBehavior, preconfigured-configuration=MemAcc_Pre, recommended-configuration=MemAcc_Rec, vendor-specific-module-def=MemAcc
  module config MemAcc_Pre: definition=MemAcc
  module config MemAcc_Rec: definition=MemAcc
