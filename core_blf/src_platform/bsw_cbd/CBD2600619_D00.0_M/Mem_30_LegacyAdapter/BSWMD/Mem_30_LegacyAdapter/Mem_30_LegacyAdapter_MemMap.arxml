AUTOSAR XML (schema 00048)
# COPYRIGHT
# Copyright (c) 2025 by Vector Informatik GmbH. All rights reserved.
# This software is copyright protected and proprietary to Vector Informatik GmbH.
# Vector Informatik GmbH grants to you only those rights as set out in the license conditions.
package /MICROSAR/Mem_30_LegacyAdapter
  bsw implementation Mem_Impl
    resource consumption ResourceConsumption
      7 x memory section:
        MEM_30_LEGACYADAPTER_CODE_ASIL_D: sw-addrmethod=CODE_ASIL_D, symbol=CODE_ASIL_D
        MEM_30_LEGACYADAPTER_CONST_DELIMITER_ASIL_D_64: alignment=64, sw-addrmethod=CONST_ASIL_D, symbol=CONST_DELIMITER_ASIL_D_64
        MEM_30_LEGACYADAPTER_CONST_HEADER_ASIL_D_UNSPECIFIED: alignment=UNSPECIFIED, sw-addrmethod=CONST_ASIL_D, symbol=CONST_HEADER_ASIL_D_UNSPECIFIED
        MEM_30_LEGACYADAPTER_CONST_ASIL_D_UNSPECIFIED: alignment=UNSPECIFIED, sw-addrmethod=CONST_ASIL_D, symbol=CONST_ASIL_D_UNSPECIFIED
        MEM_30_LEGACYADAPTER_CONFIG_DATA_PREBUILD_ASIL_D_UNSPECIFIED: alignment=UNSPECIFIED, sw-addrmethod=CONFIG_DATA_PREBUILD_ASIL_D, symbol=CONFIG_DATA_PREBUILD_ASIL_D_UNSPECIFIED
        MEM_30_LEGACYADAPTER_VAR_CLEARED_ASIL_D_8: alignment=8, sw-addrmethod=VAR_CLEARED_ASIL_D, symbol=VAR_CLEARED_ASIL_D_8
        MEM_30_LEGACYADAPTER_VAR_INIT_ASIL_D_8: alignment=8, sw-addrmethod=VAR_INIT_ASIL_D, symbol=VAR_INIT_ASIL_D_8
