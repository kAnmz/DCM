AUTOSAR XML (schema 00052)
# COPYRIGHT
# Copyright (c) 2025 by Vector Informatik GmbH. All rights reserved.
# This software is copyright protected and proprietary to Vector Informatik GmbH.
# Vector Informatik GmbH grants to you only those rights as set out in the license conditions.
package /MICROSAR/Mem_30_LegacyAdapter
  module definition Mem [0..1]: category=VENDOR_SPECIFIC_MODULE_DEFINITION, refined-module-def=Mem, variants pre-compile  # Vector Mem-to-vMem adapter. Provides services to access and operate non-volatile memory of vMem/fls/eep drivers. #NVRAM #NVMemory #Memory #DataStorage #AUTOSAR #FBL #Vector | Its multiplicity describes the actual number of Mem drivers. There will be one container for each Mem driver.
    container MemGeneral: multiplicity set at pre-compile  # Container for general configuration parameters of the Mem driver. These parameters are always pre-compile.
      boolean MemDevErrorDetect: multiplicity set at pre-compile, set at pre-compile  # This parameter switches the Development Error Detection and Reporting ON or OFF. true: Development error detection and reporting are enabled. false: Development error detection and reporting are disabled. Note: In general, the development error detection is recommended during pre-test phase. It is not recommended to enable the development error detection in production code due to increased runtime and ROM needs.
      integer MemIndex: 0..254, multiplicity set at pre-compile, set at pre-compile, symbolic-name-value=true, default-value=0  # Specifies the InstanceId of this module instance. If only one instance is present it shall have the ID 0.
      float MemMainFunctionPeriod: 0..1, multiplicity set at pre-compile, origin=Vector Informatik, set at pre-compile, default-value=0  # Not supported! MainFunction() is triggered by MemAcc. This value specifies the fixed call cycle for Mem_MainFunction().
      enumeration MemInvocation: {DIRECT_STATIC, INDIRECT_DYNAMIC, INDIRECT_STATIC}, multiplicity set at pre-compile, origin=Vector Informatik, set at pre-compile, default-value=INDIRECT_STATIC  # Only INDIRECT_STATIC and INDIRECT_DYNAMIC are supported. Default case is INDIRECT_STATIC. Use INDIRECT_DYNAMIC only when the Mem driver together with the vMem(s) are intended to be activated dynamically by the MemAcc. For more information see technical reference. Mem adapter is always accessed over the function pointer table and will be initialized and scheduled by the MemAcc.
      string MemNamePrefix: multiplicity set at pre-compile, origin=Vector Informatik, set at pre-compile, default-value=Mem_30_LegacyAdapter, max-length=255, min-length=1  # Depending on the UseMemFuncPtrTable configuration (in MemAcc), this prefix is either used to reference the Mem driver header structure or according to Mem API function.
      boolean MemUseFunctionPtrTable: multiplicity set at pre-compile, origin=Vector Informatik, set at pre-compile, default-value=true  # Not supported! Mem adapter is always accessed over the function pointer table and will be initialized and scheduled by the MemAcc.
      boolean MemSafeBswChecks: multiplicity set at pre-compile, origin=Vector Informatik, set at pre-compile, default-value=true  # Selects if safety checks are used. These checks improve robustness as e.g. invalid parameters are checked before function is executed. This attribute has to be enabled for safety projects where this component is mapped to an ASIL partition.
    container MemInstance [1..65535]: multiplicity set at pre-compile  # This container includes the Mem driver instance specific configuration parameters. | Its multiplicity describes the number of Mem driver instances of this Mem driver. There will be one container for each Mem driver instance.
      integer MemInstanceId: 0..65535, multiplicity set at pre-compile, set at pre-compile, default-value=0  # This value specifies the unique numeric identifier which is used to reference an underlying vMemInstance or FlsConfigSet or EepInitconfiguration in case multiple devices of the same type shall be addressed by one driver. This value will be assigned to the symbolic name derived from the MemInstance container short name.
      choice reference MemInstanceRef: multiplicity set at pre-compile, origin=Vector Informatik, set at pre-compile, destination=[EepInitConfiguration, FlsConfigSet, vMemInstance]  # Reference to vMemInstance or FlsConfigSet or EepInitConfiguration mapped to this MemInstance.
      container MemSectorBatch [1..*]: multiplicity set at pre-compile  # Configuration description of a programmable sector or sector batch. Sector batch means that homogenous and coherent sectors can be configured as one MemSector element. | It is recommended to group as many identical sectors as possible together.
        integer MemEraseSectorSize: 1..4294967295, multiplicity set at pre-compile, set at pre-compile, default-value=1  # Size of this sector in bytes. | A sector is the smallest erasable unit.
        integer MemMinReadSize: 1..4294967295, multiplicity set at pre-compile, set at pre-compile, default-value=1  # Not supported! Underlying drivers are not expected to have alignment requirements for read operations. Smallest readable unit in bytes. If the hardware manual specifies certain read requirements, set this parameter accordingly. Otherwise, set this parameter to the same value as MemWritePageSize.
        integer MemNumberOfSectors: 1..4294967295, multiplicity set at pre-compile, set at pre-compile, default-value=1  # Number of contiguous sectors with identical values for MemSectorSize and MemPageSize. | If this parameter is configured to be greater than 1, the sectors are grouped in a sector batch.
        integer MemSpecifiedEraseCycles: 0..4294967295, multiplicity set at pre-compile, set at pre-compile, default-value=0  # Number of erase cycles specified for the memory device (usually given in the device data sheet).
        integer MemStartAddress: 0..18446744073709551615, multiplicity set at pre-compile, set at pre-compile  # Physical start address of the sector (batch). | In case of a sector batch, the physical start address is the address of the first sector. The physical start address of the other sectors can be calculated by the MemSectorSize parameter.
        integer MemWritePageSize: 1..4294967295, multiplicity set at pre-compile, set at pre-compile, default-value=1  # Size of a write page of this sector in bytes. | A write page is the smallest writeable unit.
        container MemBurstSettings [0..1]: multiplicity set at pre-compile  # Container for burst setting configuration parameters of the Mem driver. | A sector burst can be used for improved performance.
          integer MemEraseBurstSize: 1..4294967295, multiplicity set at pre-compile, set at pre-compile, default-value=1  # Size of sector erase burst in bytes. A sector burst can be used for improved performance and is typically (a subset of) a sector batch. | To make use of the sector erase burst feature, the physical start address of the sector batch must be aligned to the sector erase burst size.
          integer MemMaxReadSize: 1..4294967295, multiplicity set at pre-compile, set at pre-compile, default-value=1  # This value specifies the maximum number of bytes the MemAcc module requests within one Mem read request. For performance reasons it is STRONGLY recommended to set this value. If it is not set to a reasonably high value, many MainFunction cycles might be needed for read requests.
          integer MemWriteBurstSize: 1..4294967295, multiplicity set at pre-compile, set at pre-compile, default-value=1  # Size of page write/program burst in bytes. A sector burst can be used for improved performance and is typically (a subset of) a sector batch. | To make use of the write burst feature, the physical start address must be aligned to the write burst size.
    container MemPublishedInformation: multiplicity set at pre-compile  # Additional published parameters not covered by CommonPublishedInformation container. | Note that these parameters do not have any configuration class setting, since they are published information.
      integer MemErasedValue: 0..4294967295, multiplicity set at pre-compile, set at pre-compile  # The contents of an erased memory cell. If it is specified in the hardware manual, use that value. Otherwise, any arbitrary value can be used.
  bsw implementation Mem_Impl: programming-language=C, sw-version=2.00.05, used-code-generator=DaVinci Configurator, vendor-id=30, ar-release-version=4.08.00, preconfigured-configuration=Mem_Pre, recommended-configuration=Mem_Rec, vendor-api-infix=LegacyAdapter, vendor-specific-module-def=Mem
  module config Mem_Rec: definition=Mem
    MemGeneral_30_LegacyAdapter (MemGeneral): MemNamePrefix=Mem_30_LegacyAdapter
