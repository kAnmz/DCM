AUTOSAR XML (schema 4-0-3)
# COPYRIGHT
# Copyright (c) 2025 by Vector Informatik GmbH. All rights reserved.
# This software is copyright protected and proprietary to Vector Informatik GmbH.
# Vector Informatik GmbH grants to you only those rights as set out in the license conditions.
package /MICROSAR/vMem_30_Traveo2Cyp01
  module config vMem_Pre: definition=vMem
    vMemPublishedInformation
      vMemDerivativeInformation
        3 x vMemPeripheral:
          FLASHC: vMemPeripheralEndAddress=1076232191, vMemPeripheralStartAddress=1076101120
          IPC: vMemPeripheralEndAddress=1076035583, vMemPeripheralStartAddress=1075970048
          FAULT: vMemPeripheralEndAddress=1075970047, vMemPeripheralStartAddress=1075904512
      vMemFlash
        12 x vMemFlashRegion:
          SingleMode_CodeFlash_LargeSectors: vMemStartAddress=268435456, vMemNumberOfSectors=254, vMemSectorSize=32768, vMemPageSize=8, vMemFlashType=CODE
          SingleMode_CodeFlash_SmallSectors: vMemStartAddress=276758528, vMemNumberOfSectors=32, vMemSectorSize=8192, vMemPageSize=8, vMemFlashType=CODE
          SingleMode_WorkFlash_LargeSectors: vMemNumberOfSectors=96, vMemStartAddress=335544320, vMemPageSize=4, vMemSectorSize=2048, vMemFlashType=WORK
          SingleMode_WorkFlash_SmallSectors: vMemStartAddress=335740928, vMemNumberOfSectors=512, vMemSectorSize=128, vMemPageSize=4, vMemFlashType=WORK
          DualMode_CodeFlash_LargeSectors_Low: vMemStartAddress=268435456, vMemNumberOfSectors=127, vMemSectorSize=32768, vMemPageSize=8, vMemFlashType=CODE
          DualMode_CodeFlash_LargeSectors_High: vMemStartAddress=301989888, vMemNumberOfSectors=127, vMemSectorSize=32768, vMemPageSize=8, vMemFlashType=CODE
          DualMode_CodeFlash_SmallSectors_Low: vMemStartAddress=272596992, vMemNumberOfSectors=16, vMemSectorSize=8192, vMemPageSize=8, vMemFlashType=CODE
          DualMode_CodeFlash_SmallSectors_High: vMemStartAddress=306151424, vMemNumberOfSectors=16, vMemSectorSize=8192, vMemPageSize=8, vMemFlashType=CODE
          DualMode_WorkFlash_LargeSectors_Low: vMemNumberOfSectors=48, vMemStartAddress=335544320, vMemPageSize=4, vMemSectorSize=2048, vMemFlashType=WORK
          DualMode_WorkFlash_LargeSectors_High: vMemNumberOfSectors=48, vMemStartAddress=352321536, vMemPageSize=4, vMemSectorSize=2048, vMemFlashType=WORK
          DualMode_WorkFlash_SmallSectors_Low: vMemStartAddress=335642624, vMemNumberOfSectors=256, vMemSectorSize=128, vMemPageSize=4, vMemFlashType=WORK
          DualMode_WorkFlash_SmallSectors_High: vMemStartAddress=352419840, vMemNumberOfSectors=256, vMemSectorSize=128, vMemPageSize=4, vMemFlashType=WORK
