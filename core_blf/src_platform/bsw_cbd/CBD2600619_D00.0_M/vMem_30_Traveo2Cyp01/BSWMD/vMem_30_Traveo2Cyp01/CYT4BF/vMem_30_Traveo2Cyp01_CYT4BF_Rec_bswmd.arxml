AUTOSAR XML (schema 4-0-3)
# COPYRIGHT
# Copyright (c) 2025 by Vector Informatik GmbH. All rights reserved.
# This software is copyright protected and proprietary to Vector Informatik GmbH.
# Vector Informatik GmbH grants to you only those rights as set out in the license conditions.
package /MICROSAR/vMem_30_Traveo2Cyp01
  module config vMem_Rec: definition=vMem
    vMemInstance
      vMemSectorList
        4 x vMemSector:
          SingleMode_CodeFlash_LargeSectors: vMemNumberOfSectors=254, vMemPageSize=8, vMemSectorSize=32768, vMemStartAddress=268435456
          SingleMode_CodeFlash_SmallSectors: vMemNumberOfSectors=32, vMemPageSize=8, vMemSectorSize=8192, vMemStartAddress=276758528
          SingleMode_WorkFlash_LargeSectors: vMemNumberOfSectors=96, vMemPageSize=4, vMemSectorSize=2048, vMemStartAddress=335544320
          SingleMode_WorkFlash_SmallSectors: vMemNumberOfSectors=512, vMemPageSize=4, vMemSectorSize=128, vMemStartAddress=335740928
