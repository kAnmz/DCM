AUTOSAR XML (schema 00048)
# COPYRIGHT
# Copyright (c) 2025 by Vector Informatik GmbH. All rights reserved.
# This software is copyright protected and proprietary to Vector Informatik GmbH.
# Vector Informatik GmbH grants to you only those rights as set out in the license conditions.
package /MICROSAR/vMem_30_Traveo2Cyp01
  bsw implementation vMem_Impl
    resource consumption ResourceConsumption
      25 x memory section:
        VMEM_30_TRAVEO2CYP01_CODE: sw-addrmethod=CODE, symbol=CODE
        VMEM_30_TRAVEO2CYP01_APPL_CODE: sw-addrmethod=CODE, symbol=APPL_CODE
        VMEM_30_TRAVEO2CYP01_CONST_PBCFG: sw-addrmethod=CONST_PBCFG, symbol=CONST_PBCFG
        VMEM_30_TRAVEO2CYP01_PBCFG: sw-addrmethod=CONST_PBCFG, symbol=PBCFG
        VMEM_30_TRAVEO2CYP01_CONST_8: alignment=8, sw-addrmethod=CONST, symbol=CONST_8
        VMEM_30_TRAVEO2CYP01_CONST_16: alignment=16, sw-addrmethod=CONST, symbol=CONST_16
        VMEM_30_TRAVEO2CYP01_CONST_32: alignment=32, sw-addrmethod=CONST, symbol=CONST_32
        VMEM_30_TRAVEO2CYP01_CONST_64: alignment=64, sw-addrmethod=CONST, symbol=CONST_64
        VMEM_30_TRAVEO2CYP01_CONST_UNSPECIFIED: alignment=UNSPECIFIED, sw-addrmethod=CONST, symbol=CONST_UNSPECIFIED
        VMEM_30_TRAVEO2CYP01_VAR_PBCFG: sw-addrmethod=VAR_PBCFG, symbol=VAR_PBCFG
        VMEM_30_TRAVEO2CYP01_VAR_NO_INIT_8: alignment=8, sw-addrmethod=VAR_NO_INIT, symbol=VAR_NO_INIT_8
        VMEM_30_TRAVEO2CYP01_VAR_NO_INIT_16: alignment=16, sw-addrmethod=VAR_NO_INIT, symbol=VAR_NO_INIT_16
        VMEM_30_TRAVEO2CYP01_VAR_NO_INIT_32: alignment=32, sw-addrmethod=VAR_NO_INIT, symbol=VAR_NO_INIT_32
        VMEM_30_TRAVEO2CYP01_VAR_NO_INIT_64: alignment=64, sw-addrmethod=VAR_NO_INIT, symbol=VAR_NO_INIT_64
        VMEM_30_TRAVEO2CYP01_VAR_NO_INIT_UNSPECIFIED: alignment=UNSPECIFIED, sw-addrmethod=VAR_NO_INIT, symbol=VAR_NO_INIT_UNSPECIFIED
        VMEM_30_TRAVEO2CYP01_VAR_INIT_8: alignment=8, sw-addrmethod=VAR_INIT, symbol=VAR_INIT_8
        VMEM_30_TRAVEO2CYP01_VAR_INIT_16: alignment=16, sw-addrmethod=VAR_INIT, symbol=VAR_INIT_16
        VMEM_30_TRAVEO2CYP01_VAR_INIT_32: alignment=32, sw-addrmethod=VAR_INIT, symbol=VAR_INIT_32
        VMEM_30_TRAVEO2CYP01_VAR_INIT_64: alignment=64, sw-addrmethod=VAR_INIT, symbol=VAR_INIT_64
        VMEM_30_TRAVEO2CYP01_VAR_INIT_UNSPECIFIED: alignment=UNSPECIFIED, sw-addrmethod=VAR_INIT, symbol=VAR_INIT_UNSPECIFIED
        VMEM_30_TRAVEO2CYP01_VAR_CLEARED_8: alignment=8, sw-addrmethod=VAR_CLEARED, symbol=VAR_CLEARED_8
        VMEM_30_TRAVEO2CYP01_VAR_CLEARED_16: alignment=16, sw-addrmethod=VAR_CLEARED, symbol=VAR_CLEARED_16
        VMEM_30_TRAVEO2CYP01_VAR_CLEARED_32: alignment=32, sw-addrmethod=VAR_CLEARED, symbol=VAR_CLEARED_32
        VMEM_30_TRAVEO2CYP01_VAR_CLEARED_64: alignment=64, sw-addrmethod=VAR_CLEARED, symbol=VAR_CLEARED_64
        VMEM_30_TRAVEO2CYP01_VAR_CLEARED_UNSPECIFIED: alignment=UNSPECIFIED, sw-addrmethod=VAR_CLEARED, symbol=VAR_CLEARED_UNSPECIFIED
