AUTOSAR XML (schema 4-0-3)
# COPYRIGHT
# Copyright (c) 2025 by Vector Informatik GmbH. All rights reserved.
# This software is copyright protected and proprietary to Vector Informatik GmbH.
# Vector Informatik GmbH grants to you only those rights as set out in the license conditions.
package /MICROSAR/vMem_30_Traveo2Cyp01
  bsw implementation vMem_Impl: programming-language=C, sw-version=3.06.00, used-code-generator=DaVinci Configurator, vendor-id=30, ar-release-version=4.0.3, behavior=vMemBehavior, preconfigured-configuration=vMem_Pre, recommended-configuration=vMem_Rec, vendor-api-infix=Traveo2Cyp01, vendor-specific-module-def=vMem
  module definition vMem [0..*]: category=VENDOR_SPECIFIC_MODULE_DEFINITION, refined-module-def=vMem, variants pre-compile  # Vector Memory driver for Traveo 2 devices. Provides services to access and operate non-volatile memory. Supports both data flash and code flash memory. #Memory #NVMemory #DataStorage #OTA #SoftwareDownload #HSM #FBL #Vector
    container vMemGeneral  # Container for general configuration parameters of the memory driver. These parameters are always pre-compile.
      boolean vMemDevErrorDetect: set at pre-compile, origin=Vector Informatik, default-value=true  # This parameter switches the Development Error Detection and Reporting ON or OFF. true: Development error detection and reporting is enabled. false: Development error detection and reporting is disabled. Note: In general, the development error detection is recommended during pre-test phase. It is not recommended to enable the development error detection in production code due to increased runtime and ROM needs.
      boolean vMemSafeBswChecks: set at pre-compile, origin=Vector Informatik, default-value=true  # Selects if safety checks are used. These checks improve robustness as e.g. invalid parameters are checked before function is executed. This attribute has to be enabled for safety projects where this component is mapped to an ASIL partition.
      boolean vMemVersionInfoApi: set at pre-compile, origin=Vector Informatik, default-value=false  # This parameter enables/disables the function GetVersionInfo() to get major, minor and patch version information. Note: This is always available and is enabled for vMem via pre-config.
      integer vMemIpcStructureId: 0..2, set at pre-compile, origin=Vector Informatik  # This parameter defines the used IPC structure. Note: Depends on the core on which the driver is executed. CM0+: Id 0 CM4_0 or CM7_0: Id 1 CM4_1 or CM7_1: Id 2
      integer vMemIpcInterruptStructureId: 1..7, set at pre-compile, origin=Vector Informatik, default-value=2  # This parameter defines the used IPC interrupt structure. Normally the driver uses the dedicated IPC interrupt structure with Id 2.
      integer vMemIpcGetLockTimeoutCounterValue: 1..1000, set at pre-compile, origin=Vector Informatik, default-value=10  # This parameter specifies how often the driver attempts to aquire the IPC until the job will be finished with result failed.
      boolean vMemUsePeripheralAccessApi: set at pre-compile, origin=Vector Informatik, default-value=false  # This parameter specifies whether the module should use osPeripheralAccess-API (e.g. because memory access is restricted by MMU) to access memory mapped registers. true: Module uses APIs provided by OS to access memory mapped registers. false: Module uses direct memory access to access memory mapped registers.
      boolean vMemSuppressEccErrors: set at pre-compile, origin=Vector Informatik, default-value=false  # This parameter specifies whether the module should suppress non-recoverable errors. true: Bus errors are suppressed (errors are silent). false: Bus errors occur if non-recoverable errors are detected. Please refer to the application note AN-ISC-8-1258_vMem_TraveoII_ECC_Handling for detailed information.
      boolean vMemReadOnlyMode: set at pre-compile, origin=Vector Informatik, default-value=false  # This parameter switches the read only mode functionality ON or OFF. true: Read only mode is enabled. false: Read only mode is disabled.
    container vMemInstance [1..2]  # This container includes the memory driver instance specific configuration parameters. Its multiplicity describes the number of memory driver instances of this memory driver, so there will be one container for each memory driver instance.
      integer vMemInstanceId: 0..65535, set at pre-compile, origin=Vector Informatik, symbolic-name-value=true, default-value=0  # This value specifies the unique numeric identifier which is used to reference a memory driver instance. It is used in order to distinguish between several memory driver instances with the same physical addresses. This value will be assigned to the symbolic name derived of the vMemInstance container short name.
      container vMemSectorList  # List of programmable sectors and pages.
        container vMemSector [1..*]  # Configuration description of a programmable sector or sector batch. Sector batch means that homogenous and coherent sectors can be configured as one vMemSector element. It is recommended to group as many identical sectors as possible together.
          integer vMemNumberOfSectors: 1..65536, set at pre-compile, origin=Vector Informatik, default-value=1  # Number of continuous sectors with identical values for vMemSectorSize and vMemPageSize. If this parameter is configured to be greater than 1, this will result in a so called "sector batch".
          integer vMemPageSize: 1..4294967296, set at pre-compile, origin=Vector Informatik  # Size of one page of this sector in bytes. A page is the smallest writeable unit.
          integer vMemSectorSize: 1..4294967296, set at pre-compile, origin=Vector Informatik  # Size of this sector in bytes. A sector is the smallest erasable unit.
          integer vMemStartAddress: 0..4294967295, set at pre-compile, origin=Vector Informatik  # Physical start address of this sector. In case of a sector batch this physical start address is the address of the first sector. The physical start address of the other sectors can be calculated by usage of parameter vMemSectorSize.
          choice reference vMemFlashRegionRef: set at pre-compile, origin=Vector Informatik, destination=vMemFlashRegion  # Reference to a physical flash region.
          container vMemBurstSettings [0..1]  # Container for burst setting configuration parameters of the memory driver. A sector burst can be used for improved performance.
            integer vMemEraseBurstSize: 1..4294967296, set at pre-compile, origin=Vector Informatik, default-value=65536  # Size of sector erase burst in bytes. A sector burst can be used for improved performance and is typically (a subset of) a sector batch. Additionally the size also prescribes a necessary alignment: The phyiscal start address must be aligned to the size value, i.e. it must an integral multiple of the burst size.
            integer vMemWriteBurstSize: 1..4294967296, set at pre-compile, origin=Vector Informatik, default-value=32  # Size of page write/program burst in bytes. A sector burst can be used for improved performance and is typically (a subset of) a sector batch. Additionally the size also prescribes a necessary alignment: The phyiscal start address must be aligned to the size value, i.e. it must an integral multiple of the burst size.
            integer vMemPageBurstRamAlignment: 1..256, set at pre-compile, origin=Vector Informatik, default-value=1  # In order to make use of page write bursts, a device might require a specific alignment of the data buffer (containing the data to be programmed to NV memory). E.g. a device specific assembly buffer must be filled dword (32bit) wise. To avoid additionaly over head the buffer passed to write routine shall be correctly aligned according to this setting in order to use bursts. Unless no alignment is necessary (value equals 1), the implementation shall check for expected alignment, and it shall reject a burst request if this check failed.
    container vMemPublishedInformation  # Container for parameter which should be accessible in a public manner.
      container vMemDerivativeInformation  # Contains derivative specific public information.
        container vMemPeripheral [0..*]  # Contains the region of the used memory mapped register regions
          integer vMemPeripheralStartAddress: 0..4294967295, set at pre-compile, origin=Vector Informatik  # The parameter defines the start address of the peripheral region. Needed to create the Os Peripheral Region container if the vMemUsePeripheralAccessApi is used.
          integer vMemPeripheralEndAddress: 0..4294967295, set at pre-compile, origin=Vector Informatik  # The parameter defines the end address of the peripheral region. Needed to create the Os Peripheral Region container if the vMemUsePeripheralAccessApi is used.
      container vMemFlash  # This container contains all derivative specific FlashRegions.
        container vMemFlashRegion [1..*]  # This container specifies all attributes defining a FlashRegion.
          integer vMemNumberOfSectors: 1..65536, set at pre-compile, origin=Vector Informatik, default-value=1  # Maximum Number of continuous sectors with identical values for vMemSectorSize and vMemPageSize. If this parameter is configured to be greater than 1, this will result in a so called "sector batch".
          integer vMemPageSize: 1..4294967296, set at pre-compile, origin=Vector Informatik  # Size of one page of this sector in bytes. A page is the smallest writeable unit.
          integer vMemSectorSize: 1..4294967296, set at pre-compile, origin=Vector Informatik  # Size of this sector in bytes. A sector is the smallest erasable unit.
          integer vMemStartAddress: 0..4294967295, set at pre-compile, origin=Vector Informatik  # Physical start address of this sector.
          enumeration vMemFlashType: {CODE, WORK}, set at pre-compile, origin=Vector Informatik  # Flash type of this sector. e.g. CodeFlash/WorkFlash.
  module config vMem_Pre: definition=vMem
    vMemGeneral: vMemVersionInfoApi=1
  module config vMem_Rec: definition=vMem
