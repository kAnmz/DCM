AUTOSAR XML (schema 4-0-3)
# COPYRIGHT
# Copyright (c) 2026 by Vector Informatik GmbH. All rights reserved.
# This software is copyright protected and proprietary to Vector Informatik GmbH.
# Vector Informatik GmbH grants to you only those rights as set out in the license conditions.
package /MICROSAR/NvMGen2
  bsw implementation NvM_Impl: programming-language=C, sw-version=3.06.02, used-code-generator=DaVinci Configurator Classic, vendor-id=30, ar-release-version=4.06.00, behavior=NvMBehavior, preconfigured-configuration=NvM_Pre, recommended-configuration=NvM_Rec, vendor-specific-module-def=NvM
  module definition NvM [0..1]: category=VENDOR_SPECIFIC_MODULE_DEFINITION, refined-module-def=NvM, variants pre-compile  # NV RAM Manager. Provides services to ensure the data storage and maintenance of NV data according to their individual requirements in an automotive environment. The NvM administrates the NV data of an EEPROM and/or a FLASH EEPROM emulation device. #NVRAM #NVMemory #DataStorage #AUTOSAR #ServiceComponent
    container NvMBlockDescriptor [1..65536]  # This container includes the configuration of one NVM block. At least one block is required to be configured. The NVRAM block descriptors are condensed in the NVRAM block descriptor table.
      enumeration NvMBlockCrcType [0..1]: {NVM_CRC16, NVM_CRC32}, set at pre-compile, default-value=NVM_CRC32  # Crc Type | This parameter defines CRC data width for the NVRAM block. Hint: The parameter is only applicable if (NvMBlockUseCrc == true).
      integer NvMBlockJobPriority: 0..255, set at pre-compile, default-value=127  # Priority | This value specifies the job priority for a NVRAM block (0 = Immediate priority).
      enumeration NvMBlockManagementType: {NVM_BLOCK_DATASET, NVM_BLOCK_NATIVE, NVM_BLOCK_REDUNDANT}, set at pre-compile, default-value=NVM_BLOCK_NATIVE  # Management Type | Defines the block management type for the NVRAM block. NVM_BLOCK_DATASET: NVRAM block is configured to be of dataset type. The application has to decide which of the n data set is handled. NVM_BLOCK_NATIVE: NVRAM block is configured to be of native type. The data is stored at one position. NVM_BLOCK_REDUNDANT : NVRAM block is configured to be of redundant type. The data is stored twice. If reading the first element fails, the modules automatically tries to read the second element.
      boolean NvMBlockUseCrc: set at pre-compile, default-value=false  # Crc usage | This parameter defines if CRC usage for the NVRAM block is enabled. Hint: The type of CRC has to be configured in NvMBlockCrcType. | true: CRC will be used for this NVRAM block. false: CRC will not be used for this NVRAM block.
      boolean NvMBlockUseSyncMechanism: set at pre-compile, default-value=false  # Use Synchronization Mechanism | This parameter defines whether an explicit synchronization mechanism with a RAM mirror and callback routines for transferring data to and from NvM module's RAM mirror is used for this block. If used, both, NvMReadRamBlockFromNvCallback and NvMWriteRamBlockToNvCallback must be set to names of appropriate functions.
      boolean NvMBlockWriteProt: set at pre-compile, default-value=false  # Write Protection | This parameter defines the initial write protection of the NV block. true: Initial block write protection is enabled. false: Initial block write protection is disabled.
      boolean NvMBswMBlockStatusInformation: set at pre-compile, default-value=false  # Block Status Information | [Not supported] This parameter defines whether BswM is informed about the current status of this block. | True: Call BswM_NvM_CurrentBlockMode on changes False: Don&rsquo;t inform BswM at all
      boolean NvMCalcRamBlockCrc [0..1]: set at pre-compile, default-value=false  # Calculate Ram Block Crc | Defines CRC (re)calculation for the permanent RAM block or NVRAM blocks which are configured to use explicit synchronization mechanism. true: CRC will be (re)calculated for this permanent RAM block.The recalculation requires calling the NvM_SetRamBlockStatus(..., TRUE) API. false: CRC will not be (re)calculated for this permanent RAM block.
      function name NvMInitBlockCallback [0..1]: set at pre-compile, default-value=NULL_PTR  # Init Block Callback | This parameter defines the block specific callback routine which shall be called if no ROM data is available for initialization of the NVRAM block. If a NULL pointer is configured, no specific callback routine shall be called for initialization of the NVRAM block with default data. | If not configured, no specific callback routine shall be called for initialization of the NVRAM block with default data.
      integer NvMMaxNumOfReadRetries [0..1]: 0..7, set at pre-compile, default-value=0  # Maximum number of read retries | [Not supported] This parameter defines the maximum number of read retries.
      integer NvMMaxNumOfWriteRetries [0..1]: 0..7, set at pre-compile, default-value=0  # Maximum number of write retries | [Not supported] This parameter defines the maximum number of write retries for a NVRAM block. See /MICROSAR/NvM/NvMCommon/NvMMaxNoOfWriteRetries instead
      integer NvMNvBlockBaseNumber [0..1]: 1..65534, set at pre-compile  # Block Base Number | [Not supported] This value specifies the link between the NVM_NVRAM_BLOCK_IDENTIFIER used by the SW-Cs and the FEE_BLOCK_NUMBER expected by the memory abstraction modules. The parameter value equals the FEE_BLOCK_NUMBER or EA_BLOCK_NUMBER shifted to the right by NvMDatasetSelectionBits bits. | Calculation Formula: value = TargetBlockReference.[Ea/Fee]BlockConfiguration.[Ea/Fee]BlockNumber >> NvMDatasetSelectionBits
      integer NvMNvBlockLength: 1..65535, set at pre-compile, default-value=1  # Block Length | This value defines the NV block data length in bytes. Hint: If a NvMRamBlockDataAddress or NvMRomBlockDataAddress is given for this block, the length given here has to match exactly the variable sizes. Caution: The parameter must only contain the size of the actual payload. The Data Integrity Record is not included. | Note: The implementer can add the attribute 'withAuto' to the parameter definition which indicates that the length can be calculated by the generator automatically (e.g. by using the sizeof operator). When 'withAuto' is set to 'true' for this parameter definition the 'isAutoValue' can be set to 'true'. If 'isAutoValue' is set to 'true' the actual value will not be considered during ECU Configuration but will be (re-)calculated by the code generator and stored in the value attribute afterwards.
      integer NvMNvBlockNum: 1..255, set at pre-compile, default-value=1  # Datasets | This value specifies the number of multiple NV blocks in a contiguous area according to the given block management type. 1-255 For NVRAM blocks to be configured of block management type NVM_BLOCK_DATASET. The actual range is limited according to NVM148. 1 For NVRAM blocks to be configured of block management type NVM_BLOCK_NATIVE 2 For NVRAM blocks to be configured of block management type NVM_BLOCK_REDUNDANT | 1-255 For NVRAM blocks to be configured of block management type NVM_BLOCK_DATASET. The actual range is limited according to NVM444. 1 For NVRAM blocks to be configured of block management type NVM_BLOCK_NATIVE 2 For NVRAM blocks to be configured of block management type NVM_BLOCK_REDUNDANT
      integer NvMNvramBlockIdentifier: 1..65535, set at pre-compile, symbolic-name-value=true, default-value=65535  # Block Identifier | This value specifies the identification of a NVRAM block via a unique block identifier. Implementation Type: NvM_BlockIdType. min = 0 max = 2^(16- NVM_DATASET_SELECTION_BITS)-1 Reserved NVRAM block IDs: 0 -> to derive multi block request results via NvM_GetErrorStatus 1 -> redundant NVRAM block which holds the configuration ID | Implementation Type: NvM_BlockIdType. min = 2 max = 2^(16- NVM_DATASET_SELECTION_BITS)-1 Reserved NVRAM block IDs: 0 -> to derive multi block request results via NvM_GetErrorStatus 1 -> redundant NVRAM block which holds the configuration ID
      integer NvMNvramDeviceId [0..1]: 0..254, set at pre-compile  # Device Id | This value specifies the NVRAM device ID where the NVRAM block is located. Calculation Formula: "value = TargetBlockReference.[Ea/Fee]BlockConfiguration.[Ea/Fee]DeviceIndex" | Calculation Formula: value = TargetBlockReference.[Ea/Fee]BlockConfiguration.[Ea/Fee]DeviceIndex
      string NvMRamBlockDataAddress [0..1]: set at pre-compile, default-value=NULL_PTR  # Ram Block Data | This parameter defines the variable name of the RAM block data. If a NULL pointer is configured, no permanent RAM data block is available for this block. | If this is not configured, no permanent RAM data block is available for the selected block management type.
      function name NvMReadRamBlockFromNvCallback [0..1]: set at pre-compile, default-value=NULL_PTR  # Read Ram Block From Nv Callback | This parameter defines the block specific callback routine which shall be called in order to let the application copy data from the NvM module's mirror to RAM block. | Implementation type: Std_ReturnType E_OK: copy was successful E_NOT_OK: copy was not successful, callback routine to be called again
      boolean NvMResistantToChangedSw: set at pre-compile, default-value=true  # Resistant To Changed Software | This parameter defines whether a NVRAM block shall be treated resistant to configuration changes or not. If there is no default data available at configuration time then the application shall be responsible for providing the default initialization data. In this case the application has to use NvM_GetErrorStatus() to be able to distinguish between first initialization and corrupted data. | true: NVRAM block is resistant to changed software. false: NVRAM block is not resistant to changed software.
      string NvMRomBlockDataAddress [0..1]: set at pre-compile, default-value=NULL_PTR  # Rom Block Data | Defines the start address of the ROM block data. If not configured, no ROM block is available for the selected block | If not configured, no ROM block is available for the selected block management type.
      integer NvMRomBlockNum [0..1]: 0..255, set at pre-compile, default-value=0  # Rom Block Number | [Not supported] This value specifies the number of multiple ROM blocks in a contiguous area according to the given block management type. 0-255 For NVRAM blocks to be configured of block management type NVM_BLOCK_DATASET. The actual range is limited according to NVM148. 0-1 For NVRAM blocks to be configured of block management type NVM_BLOCK_NATIVE 0-1 For NVRAM blocks to be configured of block management type NVM_BLOCK_REDUNDANT | 0-255 For NVRAM blocks to be configured of block management type NVM_BLOCK_DATASET. The actual range is limited according to NVM444. 0-1 For NVRAM blocks to be configured of block management type NVM_BLOCK_NATIVE 0-1 For NVRAM blocks to be configured of block management type NVM_BLOCK_REDUNDANT
      boolean NvMSelectBlockForReadAll [0..1]: set at pre-compile, default-value=true  # Select Block For ReadAll | This parameter defines whether the NVRAM block shall be processed during NvM_ReadAll or not. This configuration parameter has only influence on those NVRAM blocks which are configured to have a permanent RAM block. | true: NVRAM block shall be processed by NvM_ReadAll false: NVRAM block shall not be processed by NvM_ReadAll
      boolean NvMSelectBlockForWriteAll [0..1]: set at pre-compile, default-value=true  # Select Block For WriteAll | This parameter defines whether the NVRAM block shall be processed during NvM_WriteAll or not. This configuration parameter has only influence on those NVRAM blocks which are configured to have a permanent RAM block. | true: NVRAM block shall be processed by NvM_WriteAll false: NVRAM block shall not be processed by NvM_WriteAll
      function name NvMSingleBlockCallback [0..1]: set at pre-compile, default-value=NULL_PTR  # Single Block Callback | This parameter defines the block specific callback routine which shall be invoked on termination of each asynchronous single block request. Does not care, if "Use Job End Callback" was disabled, or if "Use Service Ports" was enabled (then the name is derived automatically).
      boolean NvMStaticBlockIDCheck [0..1]: set at pre-compile, default-value=false  # Static Block Id Check | [Not supported] This parameter defines if the Static Block ID check is enabled. | false: Static Block ID check is disabled. true: Static Block ID check is enabled.
      boolean NvMWriteBlockOnce: set at pre-compile, default-value=false  # Write Block Once | This parameter defines if write protection after first write is enabled. The NVRAM manager sets the write protection flag after the NV block was written the first time. This means that some of the NV blocks in the NVRAM should never be erased nor be replaced with the default ROM data after first initialization. true: Defines write protection after first write is enabled. false: Defines write protection after first write is disabled.
      function name NvMWriteRamBlockToNvCallback [0..1]: set at pre-compile, default-value=NULL_PTR  # Write Ram Block To Nv Callback | This parameter defines the block specific callback routine which shall be called in order to let the application copy data from RAM block to NvM module's mirror. | Implementation type: Std_ReturnType E_OK: copy was successful E_NOT_OK: copy was not successful, callback routine to be called again
      boolean NvMWriteVerification [0..1]: set at pre-compile, default-value=false  # Write Verification | [Not supported] This parameter defines if Write Verification is enabled. | false: Write verification is disabled. true: Write Verification is enabled.
      integer NvMWriteVerificationDataSize [0..1]: 1..65536, set at pre-compile, default-value=1  # Write Verification Data Size | [Not supported] This value specifies the number of bytes to compare in each step when comparing the content of a RAM Block and a block read back.
      boolean NvMUseServicePorts: set at pre-compile, origin=Vector Informatik, default-value=false  # Use Service Ports | This parameter defines if this block is accessible via service ports. The PortName will be derived from the block name.
      boolean NvMUseJobendCallback: set at pre-compile, origin=Vector Informatik, default-value=false  # Use Job End Callback | This parameter defines whether the block specific "Single Block Job End Notification" shall be invoked upon completion of block processing. If enabled, the name of the function must be specified in "Single Block Callback", unless "Use Service Ports" was enabled (then the name is derived automatically).
      boolean NvMUseInitCallback: set at pre-compile, origin=Vector Informatik, default-value=false  # Use Init Callback | This parameter defines if the configured Init Callback is used to provide default data. Note: Since the initialization status of the RTE during ReadAll processing is currently unclear (according to AUTOSAR it is not initialized), the init callback cannot be used by SW-Cs via RTE - the setting will be ignored.
      boolean NvMAutomaticBlockLength [0..1]: set at pre-compile, origin=Vector Informatik, default-value=false  # Automatic Block Length | If enabled, the actual block length will be set via sizeof(configured permanent RAM). The configurated block length marks the maximal block length, which must not be exceeded by sizeof(configured permanent RAM) - to check the configuration it is recomended to enable block length check. If NvM/NvMCommonVendorParams/NvMDataSyncParameterCombination is disabled, this feature is only available for blocks with NvMRamBlockDataAddress. Otherwise, blocks with NvMBlockUseSyncMechanism enabled are also considered but parameter NvMRamBlockDataAddress has to be configured with the correct buffer symbol.
      boolean NvMBlockLengthCheck [0..1]: set at pre-compile, origin=Vector Informatik, default-value=true  # Block Length Check | Enable or disable the block length check. Block lengths are checked during compile time, invalid lengths shall lead to compiler errors. If NvM/NvMCommonVendorParams/NvMDataSyncParameterCombination is disabled, this feature is only available for blocks with NvMRamBlockDataAddress or NvMRomBlockDataAddress. . Otherwise, blocks with NvMBlockUseSyncMechanism enabled are also considered but parameter NvMRamBlockDataAddress has to be configured with the correct buffer symbol. Caution: The Data Integrity Record is not taken into account in the Block Length Check because the NvMNvBlockLength parameter contains only the size of the actual payload.
      boolean NvMBlockLengthCheckType [0..1]: set at pre-compile, origin=Vector Informatik, default-value=true  # Block Length Check Strict | Decide whether the block length check shall be strict or non-strict strict: configured length has to exactly match the corresponding RAM or ROM length non strict: configured block length has to be lower than or equal to the corresponding RAM or ROM length Available only if block length check is enabled and automatic block length disabled (automatic block length has its own length check type).
      boolean NvMBlockUseCRCCompMechanism: set at pre-compile, default-value=false  # Defines whether the CRC of the RAM Block shall be compared during a write job with the CRC which was calculated during the last successful read or write job. CRC does not match: NvM will write data CRC matches: NvM won't write the data, but behave as if done so | true: if compare mechanism is used, false: otherwise
      boolean NvMBlockUseSetRamBlockStatus: set at pre-compile  # Defines if NvMSetRamBlockStatusApi shall be used for this block or not. Note: If NvMSetRamBlockStatusApi is disabled this configuration parameter shall be ignored. true: calling of NvMSetRamBlockStatus for this RAM block shall set the status of the RAM block. false: calling of NvMSetRamBlockStatus for this RAM block shall be ignored.
      string NvMBlockPreWriteTransformCallback [0..1]: set at pre-compile, origin=Vector Informatik, default-value=NULL_PTR  # [Not supported] Function symbol called by NvM to let the user transform the data before writing it into the NV RAM. Can only be used together with NvMBlockPostReadTransformCallback.
      string NvMBlockPostReadTransformCallback [0..1]: set at pre-compile, origin=Vector Informatik, default-value=NULL_PTR  # [Not supported] Function symbol called by NvM to let the user transform the read data back, to verify the data and to tell the NvM whether the data is valid or not. Can only be used together with NvMBlockPreWriteTransformCallback
      function name NvMInitBlockCallbackExtended [0..1]: set at pre-compile, origin=Vector Informatik, default-value=NULL_PTR  # Init Block Callback (Extended) | This parameter defines the block specific callback routine which shall be called if no ROM data is available for initialization of the NVRAM block. If a NULL pointer is configured, no specific callback routine shall be called for initialization of the NVRAM block with default data. Note: This parameter is the extended version of "Init Block Callback" (NvMInitBlockCallback). Functionality is equal, but the signature of this callback allows the integrator to write the data pointer directly and to re-use the callback implementation. Using this callback is not conform to the AUTOSAR standard and therefore cannot be used via RTE nor the "Use Service Ports" option. It is possible to use only one version of the Init Callbacks provided by NvM in order to prevent configurations with duplicated RAM initialization. | If not configured, no specific callback routine shall be called for initialization of the NVRAM block with default data.
      function name NvMSingleBlockCallbackExtended [0..1]: set at pre-compile, origin=Vector Informatik, default-value=NULL_PTR  # Single Block Callback (Extended) | This parameter defines the block specific callback routine which shall be invoked on termination of each asynchronous single block request. This callback is invoked independently from "Single Block Callback" (NvMSingleBlockCallback). When both NvMSingleBlockCallback and this parameter are configured the NvMSingleBlockCallback will be invoked first.
      integer NvMNvBlockNVRAMDataLength [0..1]: 1..65535, set at pre-compile, origin=Vector Informatik, default-value=16  # Block NV RAM Data Length | This value specified the block length in case ciphered data is stored in NV RAM - in that case the plain data length may not match the ciphered data length. This value must be filled out, if the ciphering, encryption and decryption, of the data is enabled for this block. It will be used instead of the NvMNvBlockLength to access the NV RAM. Hint: This value can be equal or bigger than 'NvMNvBlockLength' depending on the characteristics of the referenced CSM Job inside 'NvMNameOfEncryptionJob' (e.g. CSM job adds padding information)
      boolean NvMInvokeCallbacksForReadAll: set at pre-compile, origin=Vector Informatik, default-value=true  # This parameter controls whether NvMSingleBlockCallback and NvMInitBlockCallback shall be invoked during NvM_ReadAll(). Note: Some components may not be initialized yet when NvM_ReadAll() is executed (e.g. startup behavior). Invoking callbacks to an uninitialized component may lead to DET or even undefined behavior.
      boolean NvMInvokeCallbacksForWriteAll: set at pre-compile, origin=Vector Informatik, default-value=true  # [Not supported] This parameter controls whether NvMSingleBlockCallback's shall be invoked during NvM_WriteAll(). Note: Some components may not be initialized anymore when NvM_WriteAll() is executed (e.g. shutdown behavior). Invoking callbacks to an uninitialized component may lead to DET or even undefined behavior.
      boolean NvMCheckLossOfRedundancy: set at pre-compile, origin=Vector Informatik, default-value=false  # [Not supported] This parameter defines if reading redundant blocks shall also check the block's redundant data. If the block's data is no longer redundant (i.e. the data of the blocks differs) it will be reported via DEM and will no be repaired automatically. This may have a negative impact on the read performance. Note: Can only be used for redundant blocks with an enabled data integrity mechanism.
      integer NvMCsmMacSize [0..1]: 1..1024, set at pre-compile, origin=Vector Informatik, default-value=16  # This parameter represents the size of the actual MAC used for ensuring the blocks data integrity. If configured, NvM uses MAC as the only data integrity strategy for the block. This also requires to CSM MAC generation job and the CSM MAC validation job to be configured. Hint: As a consequence of using MAC, all CRC related features such as NvMCalcRamBlockCrc and NvMBlockUseCRCCompMechanism are no longer available for the block.
      function name NvMBackgroundCrcRecalcCallback [0..1]: set at pre-compile, origin=Vector Informatik, default-value=NULL_PTR  # This parameter defines the block specific callback routine which shall be invoked on termination of each background CRC recalculation for a block.
      boolean NvMBlockUseAutoValidation: set at pre-compile, default-value=false  # Auto Validation Usage | This parameter defines whether the RAM block shall be auto validated during shutdown phase.
      reference NvMCsmEncryptionJobReference [0..1]: set at pre-compile, origin=Vector Informatik, destination=CsmJob  # [Not supported] This parameter references a CSM encrypt job used to encrypt plain data before writing it to the NV RAM. If configured, NvM encrypts data before write and forwards the ciphered data to the NV RAM. If empty, the NvM writes data provided by the user (mostly plain data).
      reference NvMCsmDecryptionJobReference [0..1]: set at pre-compile, origin=Vector Informatik, destination=CsmJob  # [Not supported] This parameter references a CSM decrypt job used to decrypt ciphered data after reading it from NV RAM. If configured, NvM decrypts the data read from NV RAM and then forwards the plain data to the user. If empty, the NvM provides the data from NV RAM directly to the user.
      reference NvMCsmMacGenerationJobReference [0..1]: set at pre-compile, origin=Vector Informatik, destination=CsmJob  # This parameter references a CSM MAC generation job used to generate a MAC for ensuring the data integrity of the block. If configured, NvM uses MAC as the only data integrity strategy for the block. This also requires to CSM MAC validation job and the CSM MAC size to be configured. Hint: As a consequence of using MAC, all CRC related features such as NvMCalcRamBlockCrc and NvMBlockUseCRCCompMechanism are no longer available for the block.
      reference NvMCsmMacVerificationJobReference [0..1]: set at pre-compile, origin=Vector Informatik, destination=CsmJob  # This parameter references a CSM MAC verification job used to validate previously generated MAC for the block. If configured, NvM uses MAC as the only data integrity strategy for the block. This also requires to CSM MAC generation job and the CSM MAC size to be configured. Hint: As a consequence of using MAC, all CRC related features such as NvMCalcRamBlockCrc and NvMBlockUseCRCCompMechanism are no longer available for the block.
      reference NvMBlockEcucPartitionRef [0..1]: set at pre-compile, destination=EcucPartition  # Maps the NV block to zero or one ECUC partition to limit the access to this NV block. The ECUC partition referenced is within the subset of the ECUC partitions where the NvM is mapped to.
      choice container NvMTargetBlockReference  # Target Block Reference | This container either includes configuration of a reference to an EA or FEE block.
        container NvMEaRef [0..1]  # Ea Reference | This container includes the reference to an EEPROM Abstraction block.
          symbolic name reference NvMNameOfEaBlock: set at pre-compile, destination=EaBlockConfiguration  # Name of Ea Block | Reference to one block in the EA configuration.
        container NvMFeeRef [0..1]  # Fee Reference | This container includes the reference to a FEE block.
          symbolic name reference NvMNameOfFeeBlock: set at pre-compile, destination=FeeBlockConfiguration  # Name Of Fee Block | Reference to one block in the FEE configuration.
    container NvMCommon  # This container includes the common configuration options.
      enumeration NvMApiConfigClass: {NVM_API_CONFIG_CLASS_1, NVM_API_CONFIG_CLASS_2, NVM_API_CONFIG_CLASS_3}, set at pre-compile, default-value=NVM_API_CONFIG_CLASS_3  # API Configuration Class | This parameter specifies the available set of NvM services. For each configuration class the available services are listed below. The following services are available in all configuration classes: - NvM_Init - NvM_SetDataIndex - NvM_GetDataIndex - NvM_GetErrorStatus - NvM_GetVersionInfo - NvM_SetRamBlockStatus - NvM_ReadAll - NvM_KillReadAll - NvM_WriteAll - NvM_CancelWriteAll - NvM_KillWriteAll - NvM_MainFunction The following services are available in NVM_API_CONFIG_CLASS_2 and NVM_API_CONFIG_CLASS_3: - NvM_ReadBlock - NvM_WriteBlock - NvM_RestoreBlockDefaults - NvM_CancelJobs The following services are available in NVM_API_CONFIG_CLASS_3: - NvM_SetBlockProtection - NvM_EraseNvBlock - NvM_InvalidateNvBlock
      boolean NvMBswMMultiBlockJobStatusInformation: set at pre-compile, default-value=true  # Multi Block Job Status Information | This parameter specifies whether BswM is informed about the current status of the multiblock job. True: call BswM_NvM_CurrentJobMode if ReadAll and WriteAll are started, finished, canceled False: do not inform BswM at all
      integer NvMCompiledConfigId: 0..65535, set at pre-compile, default-value=1  # Compiled Configuration Id | This value specifies the Configuration ID regarding the NV memory layout. The NvM stores the Configuration ID in the NV RAM. On startup it compares the compiled and the stored configuration ID. If both values match, a normal NvM_ReadAll service will be executed. If the values mismatch a configuration update is detected and depending on the parameter /MICROSAR/NvM/NvMBlockDescriptor/NvMResistantToChangedSw either a normal or an extended runtime preparation will be executed (see AUTOSAR specification)
      integer NvMCrcNumOfBytes: 1..65535, set at pre-compile, default-value=64  # Crc Number of Bytes | This parameter defines the maximum number of bytes which shall be processed within one single NvM_MainFunctionCall for CRC calculation as well as for internal copy operations. Therefore this parameter has influence on maximum duration of NvM_MainFucntion, hence it also influences the setting of "Call Cycle of NvM_MainFunction" (NvMMainFunctionPeriod). In general, smaller values of "Crc Number of Bytes" allow smaller (faster) call cycles, and vice versa. Note that one NvM_MainFunction call may perform two CRC calculations of "Crc Number of Bytes". Additionally an internal copy operation (performed instead of a CRC calculation) processes more bytes (because copying step requires less CPU-instructions than CRC clacluation).
      integer NvMDatasetSelectionBits: 0..8, set at pre-compile, default-value=4  # Dataset Selection Bits | This value specifies the number of least significant bits which shall be used to address a certain dataset of a NVRAM block within the interface to the memory hardware abstraction. 0..8: Number of bits which are used for dataset or redundant block addressing. 0: No dataset or redundant NVRAM blocks are configured at all, no selection bits required. 1: In case of redundant NVRAM blocks are configured, but no dataset NVRAM blocks.
      boolean NvMDevErrorDetect: set at pre-compile, default-value=true  # Development Error Detection | This parameter switches the Development Error Detection and Notification ON or OFF. true: Development error detection is enabled. false: Development error detection is disabled. Note: In general, the development error detection is recommended during pre-test phase. It is not recommended to enable the development error detection in production code due to increased runtime and ROM needs.
      boolean NvMDrvModeSwitch: set at pre-compile, default-value=true  # Drivers Mode Switch | [Not supported] This parameter defines switching memory drivers to fast mode during performing NvM_ReadAll and NvM_WriteAll. true: Fast mode enabled. false: Fast mode disabled.
      boolean NvMDynamicConfiguration: set at pre-compile, default-value=false  # Dynamic Configuration Handling | This parameter defines to enable the dynamic configuration management handling by the NvM_ReadAll request. true: Dynamic configuration management handling enabled. false: Dynamic configuration management handling disabled.
      boolean NvMJobPrioritization: set at pre-compile, default-value=false  # Job Prioritization | This parameter defines if job prioritization handling is enabled. true: Job prioritization handling enabled. false: Job prioritization handling disabled.
      function name NvMMultiBlockCallback [0..1]: set at pre-compile, default-value=NULL_PTR  # Multi Block Callback | This parameter defines the common callback routine which shall be invoked on termination of each asynchronous multi block request. The Multi Block Callback only gets called if NvMBswMMultiBlockStatusInformation is disabled.
      boolean NvMPollingMode: set at pre-compile, default-value=true  # Polling Mode | [Not supported] This parameter defines if the polling mode in the NVRAM Manager is enabled. At the same time the callback functions useable by lower layers is disabled. true: Polling mode enabled, callback function usage disabled. false: Polling mode disabled, callback function usage enabled.
      integer NvMRepeatMirrorOperations [0..1]: 0..7, set at pre-compile, default-value=0  # Repeat Mirror Operations | [Not supported] This value specifies the number of retries to let the application copy data to or from the NvM module's mirror before postponing the current job.
      boolean NvMSetRamBlockStatusApi: set at pre-compile, default-value=true  # SetRamBlockStatus API | [Not supported] This parameter defines if API NvM_SetRamBlockStatus is available. true: API NvM_SetRamBlockStatus enabled. false: API NvM_SetRamBlockStatus disabled.
      integer NvMSizeImmediateJobQueue [0..1]: 1..65535, set at pre-compile, default-value=1  # Size Of Immediate Job Queue | This value specifies the number of queue entries for the immediate priority job queue. Hints: - If (NvMJobPrioritization == false) this parameter is ignored. - If (NvMJobPrioritization == true) this parameter must be set
      integer NvMSizeStandardJobQueue: 1..65535, set at pre-compile, default-value=8  # Size Of Standard Job Queue | This value specifies the number of queue entries for the standard job queue.
      boolean NvMVersionInfoApi: set at pre-compile, default-value=false  # Version Information API | [Not supported] This parameter enables/disables the function NvM_GetVersionInfo() to get major, minor and patch version information. | true: Version info API enabled. false: Version info API disabled.
      integer NvMMaxNoOfWriteRetries: 0..7, set at pre-compile, origin=Vector Informatik, default-value=1  # Maximum Number of Write Retries | This value specifies the maximum number of write retries for a NVRAM block. Regardless of configuration a consistency check and write retries are always forced for each block which is processed by the request NvM_WriteAll and NvM_WriteBlock. Enabling this MICROSAR parameter applies retries globally to every block, which diverges from AUTOSAR’s per-block MaxNoOfWriteRetries behavior. Setting the parameter to 0 disables retries.
      float NvMMainFunctionPeriod: 0.001..1, set at pre-compile, origin=Vector Informatik, default-value=0.01  # Call Cycle of NvM_MainFunction | Specify fixed call cycle for NvM_MainFunction. This information affects RTE's (SchM's) settings. NVM itself does not depend on a fixed cycle time; in can be triggered at arbitrary rates. It is not necessary to rigger NVM faster than its lower layers (FEE/EA and FLS/EEP). Also consider NvMCrcNumOf Bytes, which limits the maximim MainFunction processing times during CRC Calculation as well as internal copie operations. The faster you want NvM_MainFunction being triggered, the smaller this value should be and vice versa. Note, that notifcation functions may arbitrarily extend NvM_MainFunction's maximum duration. This is an issue especially for init callbacks as well as for explicit synchronization callbacks, as they would have to process a block at once.
      boolean NvMUseBlockIdCheck: set at pre-compile, origin=Vector Informatik, default-value=false  # Use Block Id Check for Blocks with Crc | If enabled, the NvM checks whether the data provided by the underlying modules belongs to the requested NvM block. This only works for blocks configured with Crc, as the NvM uses Crc for this functionality! This function remains unused if there is no block with Crc.
      boolean NvMRepairRedundantBlocksApi: set at pre-compile, origin=Vector Informatik, default-value=false  # Repair Redundant Blocks Api | [Not supported] Enables the NvM background job "Repair Redundant Blocks", which iterates over all configured redundant blocks and checks their redundancy within the NV RAM. If the redundancy is lost, the job will try to repair it.
      boolean NvMSafeBswChecks: set at pre-compile, origin=Vector Informatik, default-value=true  # Safe BSW Checks | Selects if safety checks are used. These checks improve robustness as e.g. invalid parameters are checked before function is executed. This attribute has to be enabled for safety projects where this component is mapped to an ASIL partition.
      integer NvMCsmRetryCounter [0..1]: 0..255, set at pre-compile, origin=Vector Informatik, default-value=0  # This value specifies the number of CSM encryption/decryption job retry attempts. CSM jobs for block reading and writing may fail (e.g. module busy, queue full, ...). To not directly abort the read/write with an error status, the NvM will retry the CSM job for the configured NvMCsmRetryCounter times. Configuring 0 means: no retry behavior; job will be aborted directly.
      function name NvMDetectedLossOfRedundancyCallback: set at pre-compile, origin=Vector Informatik, default-value=NULL_PTR  # [Not supported] This parameter defines the notification callback routine that will be called when a loss of redundancy was detected when reading a block. Note: Will only be invoked for blocks with enabled NvM/NvMBlockDescriptor/NvMCheckLossOfRedundancy.
      boolean NvMUseAsr440CallbackInterface: set at pre-compile, origin=Vector Informatik, default-value=false  # If enabled, the signature of following parameters will be used as defined since AUTOSAR version 4.4.0: - NvM/NvMBlockDescriptor/NvMSingleBlockCallback - NvM/NvMCommon/NvMMultiBlockCallback
      enumeration NvMMainFunctionTriggering: set at pre-compile, origin=Vector Informatik, default-value=FixedCycleTime  # The MainFunction can be scheduled in different ways, which allows adapting the runtime behavior - FixedCycleTime: All activities are executed in the MainFunction with the defined cycle time. - BackgroundTask: Activities that do not require a fixed cycle time run in the background task. The response time of such activities will depend on the current CPU load. - FixedCycleAndBackground: Both options combined - currently not supported. Note If the system is overloaded, it may happen that the background task is no longer called.
        FixedCycleTime  # FixedCycleTime Task for Fixed Cycle Time Vector Informatik
        BackgroundTask  # Task for Background Handling
        FixedCycleAndBackground  # Cycle time and background task combined option
      reference NvMEcucPartitionRef [0..*]: set at pre-compile, destination=EcucPartition  # Maps the NvM to one or multiple ECUC partitions to make its C-APIs available in the partition and the corresponding OS applications. If the NvM shall not be linked to any OS application, the parameter can be left empty.
      reference NvMMasterEcucPartitionRef [0..1]: set at pre-compile, destination=EcucPartition  # Maps the NvM master to zero or one ECUC partition to assign the master functionality to a certain core. The ECUC partition referenced is a subset of the ECUC partitions where the NvM is mapped to.
    container NvmDemEventParameterRefs [0..1]  # This container includes references to DemEventParameter elements which shall be invoked using the API Dem_SetEventStatus API in case the corresponding error occurs. The EventId is taken from the referenced DemEventParameter's DemEventId value.
      symbolic name reference NVM_E_INTEGRITY_FAILED [0..1]: set at pre-compile, destination=DemEventParameter  # Reference to the DemEventParameter which shall be issued when the error "API request integrity failed" has occurred.
      symbolic name reference NVM_E_LOSS_OF_REDUNDANCY [0..1]: set at pre-compile, destination=DemEventParameter  # Reference to the DemEventParameter which shall be issued when the error "loss of redundancy" has occurred.
      symbolic name reference NVM_E_REQ_FAILED [0..1]: set at pre-compile, destination=DemEventParameter  # Reference to the DemEventParameter which shall be issued when the error "API request failed" has occurred.
      symbolic name reference NVM_E_VERIFY_FAILED [0..1]: set at pre-compile, destination=DemEventParameter  # [Not supported] Reference to the DemEventParameter which shall be issued when the error "Write Verification failed" has occurred.
      symbolic name reference NVM_E_WRONG_BLOCK_ID [0..1]: set at pre-compile, destination=DemEventParameter  # [Not supported] Reference to the DemEventParameter which shall be issued when the error "Static Block ID check failed" has occurred.
    container NvMCommonVendorParams  # Common Vendor Parameter | This container includes Vector specific Module Configuration Parameters.
      string NvMCfgCbkIncludeList [0..*]: set at pre-compile, origin=Vector Informatik, default-value=Application.h  # Callback Include File List | This parameter contains the header file(s) declaring the call back functions, and the blocks' symbol declarations, i.e. the multi block callback the single block call backs, the block init callbacks, the ram block symbols as well as the rom block symbols.
      boolean NvMDataIntegrityIntBuffer: set at pre-compile, origin=Vector Informatik, default-value=true  # Data Integrity Buffer | This parameter defines whether the data integrity buffer is provided internally. true: The NVM provides the buffer for the data integrity value internally. Memory for data integrity must not be allocated at the end of Ram Block variable. false: The NVM does not provide the buffer for the data integrity value. Memory for data integrity value at the end of Ram Block variable is necessary!
      boolean NvMKillWriteAllApi: set at pre-compile, origin=Vector Informatik, default-value=true  # Kill WriteAll API | [Not supported] This parameter defines if the API NvM_KillWriteAll is available. The API gives users (i.e. EcuM) the possibility to time-out WriteAll cancellation (NvM_CancelWriteAll).
      boolean NvMDataSyncParameterCombination: set at pre-compile, origin=Vector Informatik, default-value=false  # Data Synchronization Parameter Combination | If enabled, the combination of the parameters NvM/NvMBlockDescriptor/NvMRamBlockDataAddress and NvM/NvMBlockDescriptor/NvMBlockUseSyncMechanism is allowed. If disabled, the combination is not allowed. This feature is there to cover the special case, that block length check and automatic block length features can also be used for blocks with explicit sync mechanism enabled.
      function name NvMProvideDynamicConfigIdCallback [0..1]: set at pre-compile, origin=Vector Informatik, default-value=NULL_PTR  # Provide Dynamic Config ID Callback | This parameter defines a callback which can provide the Config ID. This ID is then compared to the Config ID which is stored within the Config Block. This mechanism can be used instead of using the compiled Config ID. Additional Information: When using the callback, the Config ID length can be any uint16 value.
  module config NvM_Pre: definition=NvM
    NvMConfigBlock (NvMBlockDescriptor):
      NvMNvramBlockIdentifier = 1
      NvMBlockManagementType = NVM_BLOCK_REDUNDANT
      NvMNvBlockNum = 2
      NvMBlockUseCrc = true
      NvMSelectBlockForReadAll = true
      NvMResistantToChangedSw = true
      NvMUseInitCallback = false
      NvMSelectBlockForWriteAll = true
      NvMCalcRamBlockCrc = false
      NvMRomBlockDataAddress = NULL_PTR
      NvMBlockPostReadTransformCallback = NULL_PTR
      NvMBlockPreWriteTransformCallback = NULL_PTR
      NvMBlockUseSetRamBlockStatus = true
  module config NvM_Rec: definition=NvM
    NvMConfigBlock (NvMBlockDescriptor): NvMBlockCrcType=NVM_CRC32
