AUTOSAR XML (schema 00048)
# COPYRIGHT
# Copyright (c) 2026 by Vector Informatik GmbH. All rights reserved.
# This software is copyright protected and proprietary to Vector Informatik GmbH.
# Vector Informatik GmbH grants to you only those rights as set out in the license conditions.
package /MICROSAR
  bsw implementation NvM_Impl
    resource consumption ResourceConsumption
      25 x memory section:
        NVM_CODE: sw-addrmethod=CODE, symbol=CODE
        NVM_APPL_CODE: sw-addrmethod=CODE, symbol=APPL_CODE
        NVM_CONST_PBCFG: sw-addrmethod=CONST_PBCFG, symbol=CONST_PBCFG
        NVM_PBCFG: sw-addrmethod=CONST_PBCFG, symbol=PBCFG
        NVM_CONST_8: alignment=8, sw-addrmethod=CONST, symbol=CONST_8
        NVM_CONST_16: alignment=16, sw-addrmethod=CONST, symbol=CONST_16
        NVM_CONST_32: alignment=32, sw-addrmethod=CONST, symbol=CONST_32
        NVM_CONST_64: alignment=64, sw-addrmethod=CONST, symbol=CONST_64
        NVM_CONST_UNSPECIFIED: alignment=UNSPECIFIED, sw-addrmethod=CONST, symbol=CONST_UNSPECIFIED
        NVM_VAR_PBCFG: sw-addrmethod=VAR_PBCFG, symbol=VAR_PBCFG
        NVM_VAR_NO_INIT_8: alignment=8, sw-addrmethod=VAR_NO_INIT, symbol=VAR_NO_INIT_8
        NVM_VAR_NO_INIT_16: alignment=16, sw-addrmethod=VAR_NO_INIT, symbol=VAR_NO_INIT_16
        NVM_VAR_NO_INIT_32: alignment=32, sw-addrmethod=VAR_NO_INIT, symbol=VAR_NO_INIT_32
        NVM_VAR_NO_INIT_64: alignment=64, sw-addrmethod=VAR_NO_INIT, symbol=VAR_NO_INIT_64
        NVM_VAR_NO_INIT_UNSPECIFIED: alignment=UNSPECIFIED, sw-addrmethod=VAR_NO_INIT, symbol=VAR_NO_INIT_UNSPECIFIED
        NVM_VAR_INIT_8: alignment=8, sw-addrmethod=VAR_INIT, symbol=VAR_INIT_8
        NVM_VAR_INIT_16: alignment=16, sw-addrmethod=VAR_INIT, symbol=VAR_INIT_16
        NVM_VAR_INIT_32: alignment=32, sw-addrmethod=VAR_INIT, symbol=VAR_INIT_32
        NVM_VAR_INIT_64: alignment=64, sw-addrmethod=VAR_INIT, symbol=VAR_INIT_64
        NVM_VAR_INIT_UNSPECIFIED: alignment=UNSPECIFIED, sw-addrmethod=VAR_INIT, symbol=VAR_INIT_UNSPECIFIED
        NVM_VAR_CLEARED_8: alignment=8, sw-addrmethod=VAR_CLEARED, symbol=VAR_CLEARED_8
        NVM_VAR_CLEARED_16: alignment=16, sw-addrmethod=VAR_CLEARED, symbol=VAR_CLEARED_16
        NVM_VAR_CLEARED_32: alignment=32, sw-addrmethod=VAR_CLEARED, symbol=VAR_CLEARED_32
        NVM_VAR_CLEARED_64: alignment=64, sw-addrmethod=VAR_CLEARED, symbol=VAR_CLEARED_64
        NVM_VAR_CLEARED_UNSPECIFIED: alignment=UNSPECIFIED, sw-addrmethod=VAR_CLEARED, symbol=VAR_CLEARED_UNSPECIFIED
