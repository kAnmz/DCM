AUTOSAR XML (schema 4-0-3)
# COPYRIGHT
# Copyright (c) 2022 by Vector Informatik GmbH. All rights reserved.
# This software is copyright protected and proprietary to Vector Informatik GmbH.
# Vector Informatik GmbH grants to you only those rights as set out in the license conditions.
package /MICROSAR
  module definition Crc [0..1]: category=VENDOR_SPECIFIC_MODULE_DEFINITION, refined-module-def=Crc, variants pre-compile  # Cyclic Redundancy Check Library. The library provides routines for several CRC calculation algorithms. #Library #CRC #CyclicRedundancyCheck #AUTOSAR
    container CrcGeneral  # General configuration of the CRC
      enumeration Crc16Mode: set at pre-compile, default-value=CRC_16_TABLE  # 16bit-CRC Calculation Method | This switch selects one of the available CRC16 calculation methods.
        CRC_16_RUNTIME  # Runtime calculation results in smaller code size, but slower execution time.
        CRC_16_TABLE  # Table based calculation results in fast execution, but increases ROM size.
        CRC_16_TABLE_4  # Generates four tables instead of one, further increasing performance at the cost of ROM size.
        CRC_16_TABLE_8  # Generates eight tables instead of one, further increasing performance at the cost of ROM size.
      enumeration Crc32Mode: set at pre-compile, default-value=CRC_32_TABLE  # 32bit-CRC Calculation Method | This switch selects one of the available CRC32 calculation methods.
        CRC_32_RUNTIME  # Runtime calculation results in smaller code size, but slower execution time.
        CRC_32_TABLE  # Table based calculation results in fast execution, but increases ROM size.
      enumeration Crc8H2FMode: set at pre-compile, default-value=CRC_8H2F_TABLE  # 8bit-H2F CRC Calculation Method | This switch selects one of the available CRC 8-bit calculation methods with 0x2F CRC polynomial.
        CRC_8H2F_RUNTIME  # Runtime calculation results in smaller code size, but slower execution time.
        CRC_8H2F_TABLE  # Table based calculation results in fast execution, but increases ROM size.
      enumeration Crc8Mode: set at pre-compile, default-value=CRC_8_TABLE  # 8bit-CRC Calculation Method | This switch selects one of the available CRC 8-bit (SAE J1850) calculation methods.
        CRC_8_RUNTIME  # Runtime calculation results in smaller code size, but slower execution time.
        CRC_8_TABLE  # Table based calculation results in fast execution, but increases ROM size.
      boolean CrcVersionInfoApi: set at pre-compile, default-value=false  # API service Crc_GetVersionInfo | This parameter enables/disables the function Crc_GetVersionInfo() to get major, minor and patch version information.
      enumeration Crc32P4Mode: set at pre-compile, origin=Vector Informatik, default-value=CRC_32P4_TABLE  # 32bit-P4 CRC Calculation Method | Switch to select one of the available CRC 32-bit E2E Profile 4 calculation methods.
        CRC_32P4_RUNTIME  # Runtime calculation results in smaller code size, but slower execution time.
        CRC_32P4_TABLE  # Table based calculation results in fast execution, but increases ROM size.
        CRC_32P4_TABLE_4  # Generates four tables instead of one, further increasing performance at the cost of ROM size.
        CRC_32P4_TABLE_8  # Generates eight tables instead of one, further increasing performance at the cost of ROM size.
      enumeration Crc64Mode: set at pre-compile, default-value=CRC_64_TABLE  # 64-bit CRC Calculation Method | This switch selects one of the available CRC 64-bit (ECMA) calculation methods.
        CRC_64_RUNTIME  # Runtime calculation results in smaller code size, but slower execution time.
        CRC_64_TABLE  # Table based calculation results in fast execution, but increases ROM size.
        CRC_64_TABLE_4  # Generates four tables instead of one, further increasing performance at the cost of ROM size.
        CRC_64_TABLE_8  # Generates eight tables instead of one, further increasing performance at the cost of ROM size.
  bsw implementation Crc_Impl: programming-language=C, sw-version=8.00.00, used-code-generator=DaVinci Configurator, vendor-id=30, ar-release-version=4.00.03, preconfigured-configuration=Crc_Pre, recommended-configuration=Crc_Rec, vendor-specific-module-def=Crc
  module config Crc_Pre: definition=Crc
  module config Crc_Rec: definition=Crc
